SECTIONS
{
    __romPos = 0;
    _gp = 0x8005E274;
    header_ROM_START = __romPos;
    header_VRAM = ADDR(.header);
    .header : AT(header_ROM_START) SUBALIGN(4)
    {
        FILL(0x00000000);
        header_DATA_START = .;
        build/asm/header.s.o(.data);
        . = ALIGN(., 4);
        header_DATA_END = .;
        header_DATA_SIZE = ABSOLUTE(header_DATA_END - header_DATA_START);
    }
    __romPos += SIZEOF(.header);
    __romPos = ALIGN(__romPos, 4);
    . = ALIGN(., 4);
    header_ROM_END = __romPos;
    header_VRAM_END = .;

    main_ROM_START = __romPos;
    main_VRAM = ADDR(.main);
    .main 0x80010000 : AT(main_ROM_START) SUBALIGN(4)
    {
        FILL(0x00000000);
        main_RODATA_START = .;
        build/asm/data/800.rodata.s.o(.rodata);
        build/src/func_80011270.c.o(.rodata);
        build/src/__start.c.o(.rodata);
        build/src/func_80011370.c.o(.rodata);
        build/src/func_80011C24.c.o(.rodata);
        build/src/func_80011DB0.c.o(.rodata);
        build/src/func_80011EE8.c.o(.rodata);
        build/src/func_80011EF0.c.o(.rodata);
        build/src/func_80011F08.c.o(.rodata);
        build/src/func_80011F14.c.o(.rodata);
        build/src/func_80011F20.c.o(.rodata);
        build/src/func_80011F2C.c.o(.rodata);
        build/src/func_80011F38.c.o(.rodata);
        build/src/func_80011F44.c.o(.rodata);
        build/src/func_80011F50.c.o(.rodata);
        build/src/func_80011F5C.c.o(.rodata);
        build/src/func_80011FD8.c.o(.rodata);
        build/src/func_8001202C.c.o(.rodata);
        build/src/func_8001205C.c.o(.rodata);
        build/src/func_80012098.c.o(.rodata);
        build/src/func_800120BC.c.o(.rodata);
        build/src/func_800120C8.c.o(.rodata);
        build/src/func_800121D4.c.o(.rodata);
        build/src/func_80012298.c.o(.rodata);
        build/src/func_8001231C.c.o(.rodata);
        build/src/func_80012598.c.o(.rodata);
        build/src/func_800128DC.c.o(.rodata);
        build/src/func_800129E8.c.o(.rodata);
        build/src/func_800129F4.c.o(.rodata);
        build/src/func_80012A14.c.o(.rodata);
        build/src/func_80012A34.c.o(.rodata);
        build/src/func_80012A68.c.o(.rodata);
        build/src/func_80012AB0.c.o(.rodata);
        build/src/func_80012CB4.c.o(.rodata);
        build/src/func_80012D30.c.o(.rodata);
        build/src/func_8001316C.c.o(.rodata);
        build/src/func_8001328C.c.o(.rodata);
        build/src/func_800132B8.c.o(.rodata);
        build/src/func_800132F0.c.o(.rodata);
        build/src/func_80013328.c.o(.rodata);
        build/src/func_80013394.c.o(.rodata);
        build/src/func_800133B0.c.o(.rodata);
        build/src/func_800133D4.c.o(.rodata);
        build/src/func_800133E8.c.o(.rodata);
        build/src/func_80013400.c.o(.rodata);
        build/src/func_80013428.c.o(.rodata);
        build/src/func_80013430.c.o(.rodata);
        build/src/func_80013438.c.o(.rodata);
        build/src/func_80013444.c.o(.rodata);
        build/src/func_80013450.c.o(.rodata);
        build/src/func_80013488.c.o(.rodata);
        build/src/func_800134B8.c.o(.rodata);
        build/src/func_800134C4.c.o(.rodata);
        build/src/func_80013668.c.o(.rodata);
        build/src/func_800136D4.c.o(.rodata);
        build/src/func_800139FC.c.o(.rodata);
        build/src/func_80013A24.c.o(.rodata);
        build/src/func_80013AA4.c.o(.rodata);
        build/src/func_80013AC8.c.o(.rodata);
        build/src/func_80013AEC.c.o(.rodata);
        build/src/func_80013AF8.c.o(.rodata);
        build/src/func_80013B04.c.o(.rodata);
        build/src/func_80013CD0.c.o(.rodata);
        build/src/func_80013F90.c.o(.rodata);
        build/src/func_80013FC0.c.o(.rodata);
        build/src/func_80014064.c.o(.rodata);
        build/src/func_800140C8.c.o(.rodata);
        build/src/func_8001413C.c.o(.rodata);
        build/src/func_80014250.c.o(.rodata);
        build/src/func_800142D8.c.o(.rodata);
        build/src/func_80014388.c.o(.rodata);
        build/src/func_80014494.c.o(.rodata);
        build/src/func_80014554.c.o(.rodata);
        build/src/func_800145F0.c.o(.rodata);
        build/src/func_80014748.c.o(.rodata);
        build/src/func_800147BC.c.o(.rodata);
        build/src/func_80014854.c.o(.rodata);
        build/src/func_80014988.c.o(.rodata);
        build/src/func_80014B38.c.o(.rodata);
        build/src/func_80014B44.c.o(.rodata);
        build/src/func_80014BCC.c.o(.rodata);
        build/src/func_80014CB0.c.o(.rodata);
        build/src/func_80014CBC.c.o(.rodata);
        build/src/func_80014E90.c.o(.rodata);
        build/src/func_80014F0C.c.o(.rodata);
        build/src/func_80014FAC.c.o(.rodata);
        build/src/func_80015074.c.o(.rodata);
        build/src/func_80015114.c.o(.rodata);
        build/src/func_800151B4.c.o(.rodata);
        build/src/func_8001526C.c.o(.rodata);
        build/src/func_8001530C.c.o(.rodata);
        build/src/func_800153BC.c.o(.rodata);
        build/src/func_800154CC.c.o(.rodata);
        build/src/func_80015594.c.o(.rodata);
        build/src/func_80015644.c.o(.rodata);
        build/src/func_80015704.c.o(.rodata);
        build/src/func_80015814.c.o(.rodata);
        build/src/func_80015828.c.o(.rodata);
        build/src/func_80015840.c.o(.rodata);
        build/src/func_8001585C.c.o(.rodata);
        build/src/func_80015868.c.o(.rodata);
        build/src/func_80015880.c.o(.rodata);
        build/src/func_8001588C.c.o(.rodata);
        build/src/func_80015894.c.o(.rodata);
        build/src/func_8001589C.c.o(.rodata);
        build/src/func_800158D8.c.o(.rodata);
        build/src/func_800158E4.c.o(.rodata);
        build/src/func_80015A18.c.o(.rodata);
        build/src/func_80015A34.c.o(.rodata);
        build/src/func_80015AA4.c.o(.rodata);
        build/src/func_80015AAC.c.o(.rodata);
        build/src/func_80015B1C.c.o(.rodata);
        build/src/func_80015B24.c.o(.rodata);
        build/src/func_80015BF0.c.o(.rodata);
        build/src/func_80015C50.c.o(.rodata);
        build/src/func_80015CA0.c.o(.rodata);
        build/src/func_80015D1C.c.o(.rodata);
        build/src/func_80015D6C.c.o(.rodata);
        build/src/func_80015DD4.c.o(.rodata);
        build/src/func_80015E3C.c.o(.rodata);
        build/src/func_80015E78.c.o(.rodata);
        build/src/func_80015EE8.c.o(.rodata);
        build/src/func_80015F80.c.o(.rodata);
        build/src/func_80016054.c.o(.rodata);
        build/src/func_800160C8.c.o(.rodata);
        build/src/func_800161AC.c.o(.rodata);
        build/src/func_80016280.c.o(.rodata);
        build/src/func_800165D8.c.o(.rodata);
        build/src/func_80016B7C.c.o(.rodata);
        build/src/func_80016C08.c.o(.rodata);
        build/src/func_8001719C.c.o(.rodata);
        build/src/func_800171CC.c.o(.rodata);
        build/src/func_80017200.c.o(.rodata);
        build/src/func_80017240.c.o(.rodata);
        build/src/func_80017284.c.o(.rodata);
        build/src/func_80017300.c.o(.rodata);
        build/src/func_8001782C.c.o(.rodata);
        build/src/func_800179E8.c.o(.rodata);
        build/src/func_80017A08.c.o(.rodata);
        build/src/func_80017A38.c.o(.rodata);
        build/src/func_80017A48.c.o(.rodata);
        build/src/func_80017A64.c.o(.rodata);
        build/src/func_80017A70.c.o(.rodata);
        build/src/func_80017AA0.c.o(.rodata);
        build/src/func_80017AC0.c.o(.rodata);
        build/src/func_80017AC4.c.o(.rodata);
        build/src/func_80017ACC.c.o(.rodata);
        build/src/func_80017AE8.c.o(.rodata);
        build/src/func_80017B18.c.o(.rodata);
        build/src/func_80017B24.c.o(.rodata);
        build/src/func_80017B30.c.o(.rodata);
        build/src/func_80017B3C.c.o(.rodata);
        build/src/func_80017BC8.c.o(.rodata);
        build/src/func_80017C04.c.o(.rodata);
        build/src/func_80017C24.c.o(.rodata);
        build/src/func_80017C30.c.o(.rodata);
        build/src/func_80017C3C.c.o(.rodata);
        build/src/func_80017C4C.c.o(.rodata);
        build/src/func_80017CF4.c.o(.rodata);
        build/src/func_80017D9C.c.o(.rodata);
        build/src/func_80017E34.c.o(.rodata);
        build/src/func_80017EA0.c.o(.rodata);
        build/src/func_80017EE4.c.o(.rodata);
        build/src/func_80017EEC.c.o(.rodata);
        build/src/func_80017EF0.c.o(.rodata);
        build/src/func_80017F10.c.o(.rodata);
        build/src/func_80017F28.c.o(.rodata);
        build/src/func_80017F30.c.o(.rodata);
        build/src/func_80017F88.c.o(.rodata);
        build/src/func_800183B8.c.o(.rodata);
        build/src/func_800183D0.c.o(.rodata);
        build/src/func_800183E0.c.o(.rodata);
        build/src/func_80018B8C.c.o(.rodata);
        build/src/func_80018B98.c.o(.rodata);
        build/src/func_80019030.c.o(.rodata);
        build/src/func_80019070.c.o(.rodata);
        build/src/func_800191B4.c.o(.rodata);
        build/src/func_8001929C.c.o(.rodata);
        build/src/func_800193F0.c.o(.rodata);
        build/src/func_8001945C.c.o(.rodata);
        build/src/func_80019564.c.o(.rodata);
        build/src/func_800195F4.c.o(.rodata);
        build/src/func_80019600.c.o(.rodata);
        build/src/func_80019610.c.o(.rodata);
        build/src/func_800197FC.c.o(.rodata);
        build/src/func_800198E0.c.o(.rodata);
        build/src/func_800199F8.c.o(.rodata);
        build/src/func_80019AD0.c.o(.rodata);
        build/src/func_80019CBC.c.o(.rodata);
        build/src/func_80019E14.c.o(.rodata);
        build/src/func_80019E50.c.o(.rodata);
        build/src/func_80019E80.c.o(.rodata);
        build/src/func_80019FAC.c.o(.rodata);
        build/src/func_80019FC4.c.o(.rodata);
        build/src/func_8001A018.c.o(.rodata);
        build/src/func_8001A11C.c.o(.rodata);
        build/src/func_8001A19C.c.o(.rodata);
        build/src/func_8001A284.c.o(.rodata);
        build/src/func_8001A574.c.o(.rodata);
        build/src/func_8001A668.c.o(.rodata);
        build/src/func_8001A6FC.c.o(.rodata);
        build/src/func_8001A790.c.o(.rodata);
        build/src/func_8001A808.c.o(.rodata);
        build/src/func_8001A870.c.o(.rodata);
        build/src/func_8001A8D0.c.o(.rodata);
        build/src/func_8001A8FC.c.o(.rodata);
        build/src/func_8001A910.c.o(.rodata);
        build/src/func_8001A940.c.o(.rodata);
        build/src/func_8001A948.c.o(.rodata);
        build/src/func_8001A950.c.o(.rodata);
        build/src/func_8001A958.c.o(.rodata);
        build/src/func_8001A960.c.o(.rodata);
        build/src/func_8001A968.c.o(.rodata);
        build/src/func_8001A970.c.o(.rodata);
        build/src/func_8001AA7C.c.o(.rodata);
        build/src/func_8001AAB8.c.o(.rodata);
        build/src/func_8001AAF4.c.o(.rodata);
        build/src/func_8001ABF0.c.o(.rodata);
        build/src/func_8001AC10.c.o(.rodata);
        build/src/func_8001ACA0.c.o(.rodata);
        build/src/func_8001ACBC.c.o(.rodata);
        build/src/func_8001AD00.c.o(.rodata);
        build/src/func_8001AD6C.c.o(.rodata);
        build/src/func_8001ADD8.c.o(.rodata);
        build/src/func_8001AE34.c.o(.rodata);
        build/src/func_8001AF34.c.o(.rodata);
        build/src/func_8001AF44.c.o(.rodata);
        build/src/func_8001AF70.c.o(.rodata);
        build/src/func_8001AFB0.c.o(.rodata);
        build/src/func_8001AFE0.c.o(.rodata);
        build/src/func_8001B028.c.o(.rodata);
        build/src/func_8001B074.c.o(.rodata);
        build/src/func_8001B100.c.o(.rodata);
        build/src/func_8001B10C.c.o(.rodata);
        build/src/func_8001B118.c.o(.rodata);
        build/src/func_8001B258.c.o(.rodata);
        build/src/func_8001B2CC.c.o(.rodata);
        build/src/func_8001B3CC.c.o(.rodata);
        build/src/func_8001B3EC.c.o(.rodata);
        build/src/func_8001B4D0.c.o(.rodata);
        build/src/func_8001B4E4.c.o(.rodata);
        build/src/func_8001B530.c.o(.rodata);
        build/src/func_8001B5DC.c.o(.rodata);
        build/src/func_8001B6A0.c.o(.rodata);
        build/src/func_8001B9F8.c.o(.rodata);
        build/src/func_8001BA18.c.o(.rodata);
        build/src/func_8001BA40.c.o(.rodata);
        build/src/func_8001BA5C.c.o(.rodata);
        build/src/func_8001BAC4.c.o(.rodata);
        build/src/func_8001BB28.c.o(.rodata);
        build/src/func_8001BB88.c.o(.rodata);
        build/src/func_8001BBD8.c.o(.rodata);
        build/src/func_8001BD64.c.o(.rodata);
        build/src/func_8001BE18.c.o(.rodata);
        build/src/func_8001BF74.c.o(.rodata);
        build/src/func_8001BF88.c.o(.rodata);
        build/src/func_8001BF9C.c.o(.rodata);
        build/src/func_8001BFA8.c.o(.rodata);
        build/src/func_8001BFD8.c.o(.rodata);
        build/src/func_8001BFE0.c.o(.rodata);
        build/src/func_8001BFEC.c.o(.rodata);
        build/src/func_8001C0D4.c.o(.rodata);
        build/src/func_8001C1C0.c.o(.rodata);
        build/src/func_8001C37C.c.o(.rodata);
        build/src/func_8001D21C.c.o(.rodata);
        build/src/func_8001D284.c.o(.rodata);
        build/src/func_8001D288.c.o(.rodata);
        build/src/func_8001D2A4.c.o(.rodata);
        build/src/func_8001D2D0.c.o(.rodata);
        build/src/func_8001D2D8.c.o(.rodata);
        build/src/func_8001D2F4.c.o(.rodata);
        build/src/func_8001D2FC.c.o(.rodata);
        build/src/func_8001D340.c.o(.rodata);
        build/src/func_8001D348.c.o(.rodata);
        build/src/func_8001D648.c.o(.rodata);
        build/src/func_8001D678.c.o(.rodata);
        build/src/func_8001D6AC.c.o(.rodata);
        build/src/func_8001D6B8.c.o(.rodata);
        build/src/func_8001D86C.c.o(.rodata);
        build/src/func_8001D884.c.o(.rodata);
        build/src/func_8001D8A0.c.o(.rodata);
        build/src/func_8001D8B8.c.o(.rodata);
        build/src/func_8001DBF0.c.o(.rodata);
        build/src/func_8001DCA8.c.o(.rodata);
        build/src/func_8001DCB0.c.o(.rodata);
        build/src/func_8001DE4C.c.o(.rodata);
        build/src/func_8001DFC8.c.o(.rodata);
        build/src/func_8001DFD4.c.o(.rodata);
        build/src/func_8001E04C.c.o(.rodata);
        build/src/func_8001E088.c.o(.rodata);
        build/src/func_8001E0B8.c.o(.rodata);
        build/src/func_8001E158.c.o(.rodata);
        build/src/func_8001E160.c.o(.rodata);
        build/src/func_8001E26C.c.o(.rodata);
        build/src/func_8001E334.c.o(.rodata);
        build/src/func_8001E340.c.o(.rodata);
        build/src/func_8001E38C.c.o(.rodata);
        build/src/func_8001E4C0.c.o(.rodata);
        build/src/func_8001E6FC.c.o(.rodata);
        build/src/func_8001E78C.c.o(.rodata);
        build/src/func_8001E7B8.c.o(.rodata);
        build/src/func_8001E7C0.c.o(.rodata);
        build/src/func_8001E7DC.c.o(.rodata);
        build/src/func_8001E818.c.o(.rodata);
        build/src/func_8001E820.c.o(.rodata);
        build/src/func_8001E878.c.o(.rodata);
        build/src/func_8001E9F8.c.o(.rodata);
        build/src/func_8001EAE4.c.o(.rodata);
        build/src/func_8001EF8C.c.o(.rodata);
        build/src/func_8001EF98.c.o(.rodata);
        build/src/func_8001EFA4.c.o(.rodata);
        build/src/func_8001F038.c.o(.rodata);
        build/src/func_8001F084.c.o(.rodata);
        build/src/func_8001F100.c.o(.rodata);
        build/src/func_8001F190.c.o(.rodata);
        build/src/func_8001F1B4.c.o(.rodata);
        build/src/func_8001F1C0.c.o(.rodata);
        build/src/func_8001F1E0.c.o(.rodata);
        build/src/func_8001F250.c.o(.rodata);
        build/src/func_8001F278.c.o(.rodata);
        build/src/func_8001F2EC.c.o(.rodata);
        build/src/func_8001F338.c.o(.rodata);
        build/src/func_8001F35C.c.o(.rodata);
        build/src/func_8001F39C.c.o(.rodata);
        build/src/func_8001F3DC.c.o(.rodata);
        build/src/func_8001F41C.c.o(.rodata);
        build/src/func_8001F424.c.o(.rodata);
        build/src/func_8001F42C.c.o(.rodata);
        build/src/func_8001F5B8.c.o(.rodata);
        build/src/func_8001F5EC.c.o(.rodata);
        build/src/func_8001F664.c.o(.rodata);
        build/src/func_8001F774.c.o(.rodata);
        build/src/func_8001F8A4.c.o(.rodata);
        build/src/func_8001FA0C.c.o(.rodata);
        build/src/func_8001FA98.c.o(.rodata);
        build/src/func_8001FAB4.c.o(.rodata);
        build/src/func_8001FABC.c.o(.rodata);
        build/src/func_8001FAE8.c.o(.rodata);
        build/src/func_8001FB08.c.o(.rodata);
        build/src/func_8001FB10.c.o(.rodata);
        build/src/func_8001FB30.c.o(.rodata);
        build/src/func_8001FBBC.c.o(.rodata);
        build/src/func_8001FBE4.c.o(.rodata);
        build/src/func_8001FBF0.c.o(.rodata);
        build/src/func_8001FCDC.c.o(.rodata);
        build/src/func_8001FCE4.c.o(.rodata);
        build/src/func_8001FD10.c.o(.rodata);
        build/src/func_8001FD74.c.o(.rodata);
        build/src/func_8001FD84.c.o(.rodata);
        build/src/func_8001FE00.c.o(.rodata);
        build/src/func_8001FE34.c.o(.rodata);
        build/src/func_8001FE6C.c.o(.rodata);
        build/src/func_8001FE7C.c.o(.rodata);
        build/src/func_8001FEA4.c.o(.rodata);
        build/src/func_8001FF70.c.o(.rodata);
        build/src/func_8001FF98.c.o(.rodata);
        build/src/func_800200E4.c.o(.rodata);
        build/src/func_80020148.c.o(.rodata);
        build/src/func_80020174.c.o(.rodata);
        build/src/func_800201C4.c.o(.rodata);
        build/src/func_8002029C.c.o(.rodata);
        build/src/func_800202F8.c.o(.rodata);
        build/src/func_8002039C.c.o(.rodata);
        build/src/func_8002040C.c.o(.rodata);
        build/src/func_80020414.c.o(.rodata);
        build/src/func_8002047C.c.o(.rodata);
        build/src/func_800204E0.c.o(.rodata);
        build/src/func_80020540.c.o(.rodata);
        build/src/func_80020570.c.o(.rodata);
        build/src/func_8002066C.c.o(.rodata);
        build/src/func_80020768.c.o(.rodata);
        build/src/func_80020790.c.o(.rodata);
        build/src/func_800207DC.c.o(.rodata);
        build/src/func_800207E4.c.o(.rodata);
        build/src/func_80020818.c.o(.rodata);
        build/src/func_80020900.c.o(.rodata);
        build/src/func_8002093C.c.o(.rodata);
        build/src/func_80020964.c.o(.rodata);
        build/src/func_8002098C.c.o(.rodata);
        build/src/func_800209B0.c.o(.rodata);
        build/src/func_800209D4.c.o(.rodata);
        build/src/func_800209F4.c.o(.rodata);
        build/src/func_80020A14.c.o(.rodata);
        build/src/func_80020A40.c.o(.rodata);
        build/src/func_80020A70.c.o(.rodata);
        build/src/func_80020A7C.c.o(.rodata);
        build/src/func_80020A88.c.o(.rodata);
        build/src/func_80020A94.c.o(.rodata);
        build/src/func_80020B80.c.o(.rodata);
        build/src/func_80020E38.c.o(.rodata);
        build/src/func_80020E58.c.o(.rodata);
        build/src/func_800212A8.c.o(.rodata);
        build/src/func_80021484.c.o(.rodata);
        build/src/func_800214FC.c.o(.rodata);
        build/src/func_800215EC.c.o(.rodata);
        build/src/func_80021604.c.o(.rodata);
        build/src/func_80021668.c.o(.rodata);
        build/src/func_800217B0.c.o(.rodata);
        build/src/func_80021818.c.o(.rodata);
        build/src/func_80021820.c.o(.rodata);
        build/src/func_80021844.c.o(.rodata);
        build/src/func_800218A8.c.o(.rodata);
        build/src/func_800218BC.c.o(.rodata);
        build/src/func_800218C4.c.o(.rodata);
        build/src/func_8002194C.c.o(.rodata);
        build/src/func_80021B20.c.o(.rodata);
        build/src/func_80021B64.c.o(.rodata);
        build/src/func_80021B84.c.o(.rodata);
        build/src/func_80021B88.c.o(.rodata);
        build/src/func_80021B90.c.o(.rodata);
        build/src/func_80021CD8.c.o(.rodata);
        build/src/func_80021D64.c.o(.rodata);
        build/src/func_80021D70.c.o(.rodata);
        build/src/func_80021D78.c.o(.rodata);
        build/src/func_80021D80.c.o(.rodata);
        build/src/func_80021D88.c.o(.rodata);
        build/src/func_80021D90.c.o(.rodata);
        build/src/func_80021D98.c.o(.rodata);
        build/src/func_80021DA0.c.o(.rodata);
        build/src/func_80021DA8.c.o(.rodata);
        build/src/func_80021E60.c.o(.rodata);
        build/src/func_80021FD0.c.o(.rodata);
        build/src/func_80021FE4.c.o(.rodata);
        build/src/func_80022008.c.o(.rodata);
        build/src/func_80022014.c.o(.rodata);
        build/src/func_80022028.c.o(.rodata);
        build/src/func_80022030.c.o(.rodata);
        build/src/func_80022048.c.o(.rodata);
        build/src/func_8002206C.c.o(.rodata);
        build/src/func_8002238C.c.o(.rodata);
        build/src/func_800223B0.c.o(.rodata);
        build/src/func_800223D4.c.o(.rodata);
        build/src/func_800224F0.c.o(.rodata);
        build/src/func_80022528.c.o(.rodata);
        build/src/func_80022580.c.o(.rodata);
        build/src/func_800225B8.c.o(.rodata);
        build/src/func_800225C4.c.o(.rodata);
        build/src/func_8002261C.c.o(.rodata);
        build/src/func_800226A4.c.o(.rodata);
        build/src/func_800226B0.c.o(.rodata);
        build/src/func_800226D8.c.o(.rodata);
        build/src/func_800226E4.c.o(.rodata);
        build/src/func_800226F0.c.o(.rodata);
        build/src/func_80022738.c.o(.rodata);
        build/src/func_80022788.c.o(.rodata);
        build/src/func_80022794.c.o(.rodata);
        build/src/func_80022964.c.o(.rodata);
        build/src/func_800229F4.c.o(.rodata);
        build/src/func_80022AF0.c.o(.rodata);
        build/src/func_80022B20.c.o(.rodata);
        build/src/func_80022B98.c.o(.rodata);
        build/src/func_80022D70.c.o(.rodata);
        build/src/func_80022DF8.c.o(.rodata);
        build/src/func_80022EA4.c.o(.rodata);
        build/src/func_80022F1C.c.o(.rodata);
        build/src/func_80022F80.c.o(.rodata);
        build/src/func_80022F90.c.o(.rodata);
        build/src/func_80022FA0.c.o(.rodata);
        build/src/func_80022FB4.c.o(.rodata);
        build/src/func_80022FD4.c.o(.rodata);
        build/src/func_80022FD8.c.o(.rodata);
        build/src/func_80022FE0.c.o(.rodata);
        build/src/func_8002301C.c.o(.rodata);
        build/src/func_80023030.c.o(.rodata);
        build/src/func_80023060.c.o(.rodata);
        build/src/func_80023100.c.o(.rodata);
        build/src/func_80023130.c.o(.rodata);
        build/src/func_80023170.c.o(.rodata);
        build/src/func_800231AC.c.o(.rodata);
        build/src/func_800231E8.c.o(.rodata);
        build/src/func_80023288.c.o(.rodata);
        build/src/func_800233B4.c.o(.rodata);
        build/src/func_8002348C.c.o(.rodata);
        build/src/func_80023600.c.o(.rodata);
        build/src/func_800236EC.c.o(.rodata);
        build/src/func_80023710.c.o(.rodata);
        build/src/func_8002374C.c.o(.rodata);
        build/src/func_80023774.c.o(.rodata);
        build/src/func_80023794.c.o(.rodata);
        build/src/func_800237FC.c.o(.rodata);
        build/src/func_80023910.c.o(.rodata);
        build/src/func_800239F8.c.o(.rodata);
        build/src/func_80023A74.c.o(.rodata);
        build/src/func_80023A9C.c.o(.rodata);
        build/src/func_80023B5C.c.o(.rodata);
        build/src/func_80023C2C.c.o(.rodata);
        build/src/func_80023CA4.c.o(.rodata);
        build/src/func_80023CE8.c.o(.rodata);
        build/src/func_80023D08.c.o(.rodata);
        build/src/func_80023DBC.c.o(.rodata);
        build/src/func_80024030.c.o(.rodata);
        build/src/func_80024108.c.o(.rodata);
        build/src/func_800241EC.c.o(.rodata);
        build/src/func_8002437C.c.o(.rodata);
        build/src/func_800243A4.c.o(.rodata);
        build/src/func_800243C0.c.o(.rodata);
        build/src/func_800243C8.c.o(.rodata);
        build/src/func_800243D0.c.o(.rodata);
        build/src/func_800243F8.c.o(.rodata);
        build/src/func_80024400.c.o(.rodata);
        build/src/func_80024408.c.o(.rodata);
        build/src/func_80024430.c.o(.rodata);
        build/src/func_80024434.c.o(.rodata);
        build/src/func_80024440.c.o(.rodata);
        build/src/func_80024448.c.o(.rodata);
        build/src/func_800244FC.c.o(.rodata);
        build/src/func_80024578.c.o(.rodata);
        build/src/func_800245C8.c.o(.rodata);
        build/src/func_800245F4.c.o(.rodata);
        build/src/func_8002462C.c.o(.rodata);
        build/src/func_80024664.c.o(.rodata);
        build/src/func_8002469C.c.o(.rodata);
        build/src/func_800246D4.c.o(.rodata);
        build/src/func_8002470C.c.o(.rodata);
        build/src/func_80024764.c.o(.rodata);
        build/src/func_80024770.c.o(.rodata);
        build/src/func_800247C0.c.o(.rodata);
        build/src/func_80024810.c.o(.rodata);
        build/src/func_80024860.c.o(.rodata);
        build/src/func_800248B0.c.o(.rodata);
        build/src/func_800248E8.c.o(.rodata);
        build/src/func_80024924.c.o(.rodata);
        build/src/func_8002495C.c.o(.rodata);
        build/src/func_800249B4.c.o(.rodata);
        build/src/func_800249C0.c.o(.rodata);
        build/src/func_80024A10.c.o(.rodata);
        build/src/func_80024A4C.c.o(.rodata);
        build/src/func_80038674.c.o(.rodata);
        build/lib/libmath/sin00.o(.rdata);
        build/lib/libmath/sin01.o(.rdata);
        build/lib/libspu/spu.o(.rdata);
        build/lib/libspu/s_sca.o(.rdata);
        build/lib/libsnd/ssopenq.o(.rdata);
        build/lib/libsnd/seqinit.o(.rdata);
        build/lib/libsnd/sstick.o(.rdata);
        build/lib/libspu/s_sva.o(.rdata);
        build/lib/libetc/vsync.o(.rdata);
        build/lib/libetc/intr.o(.rdata);
        build/lib/libetc/intr_dma.o(.rdata);
        build/lib/libcd/event.o(.rdata);
        build/lib/libcd/iso9660.o(.rdata);
        build/lib/libcd/bios_1.o(.rdata);
        build/lib/libcd/cdr_1.o(.rdata);
        build/lib/libgs/gs_108.o(.rdata);
        build/lib/libgpu/font.o(.rdata);
        build/lib/libgpu/kprintf.o(.rdata);
        build/lib/libgpu/sys.o(.rdata);
        build/lib/libgpu/kt01.o(.rdata);
        build/lib/libgpu/kt02.o(.rdata);
        build/lib/libmcrd/libmcrd.o(.rdata);
        build/lib/libmcrd/userfunc.o(.rdata);
        build/lib/libmcrd/low.o(.rdata);
        build/lib/libmcrd/unformat.o(.rdata);
        build/lib/libc/sprintf.o(.rdata);
        build/lib/libmcx/mcxcmd6.o(.rdata);
        build/lib/libmcx/mcxcmd8.o(.rdata);
        build/lib/libmcx/mcxcmd24.o(.rdata);
        . = ALIGN(., 4);
        main_RODATA_END = .;
        main_RODATA_SIZE = ABSOLUTE(main_RODATA_END - main_RODATA_START);
        main_TEXT_START = .;
        build/src/func_80011270.c.o(.text);
        build/src/__start.c.o(.text);
        build/src/func_80011370.c.o(.text);
        build/src/func_80011C24.c.o(.text);
        build/src/func_80011DB0.c.o(.text);
        build/src/func_80011EE8.c.o(.text);
        build/src/func_80011EF0.c.o(.text);
        build/src/func_80011F08.c.o(.text);
        build/src/func_80011F14.c.o(.text);
        build/src/func_80011F20.c.o(.text);
        build/src/func_80011F2C.c.o(.text);
        build/src/func_80011F38.c.o(.text);
        build/src/func_80011F44.c.o(.text);
        build/src/func_80011F50.c.o(.text);
        build/src/func_80011F5C.c.o(.text);
        build/src/func_80011FD8.c.o(.text);
        build/src/func_8001202C.c.o(.text);
        build/src/func_8001205C.c.o(.text);
        build/src/func_80012098.c.o(.text);
        build/src/func_800120BC.c.o(.text);
        build/src/func_800120C8.c.o(.text);
        build/src/func_800121D4.c.o(.text);
        build/src/func_80012298.c.o(.text);
        build/src/func_8001231C.c.o(.text);
        build/src/func_80012598.c.o(.text);
        build/src/func_800128DC.c.o(.text);
        build/src/func_800129E8.c.o(.text);
        build/src/func_800129F4.c.o(.text);
        build/src/func_80012A14.c.o(.text);
        build/src/func_80012A34.c.o(.text);
        build/src/func_80012A68.c.o(.text);
        build/src/func_80012AB0.c.o(.text);
        build/src/func_80012CB4.c.o(.text);
        build/src/func_80012D30.c.o(.text);
        build/src/func_8001316C.c.o(.text);
        build/src/func_8001328C.c.o(.text);
        build/src/func_800132B8.c.o(.text);
        build/src/func_800132F0.c.o(.text);
        build/src/func_80013328.c.o(.text);
        build/src/func_80013394.c.o(.text);
        build/src/func_800133B0.c.o(.text);
        build/src/func_800133D4.c.o(.text);
        build/src/func_800133E8.c.o(.text);
        build/src/func_80013400.c.o(.text);
        build/src/func_80013428.c.o(.text);
        build/src/func_80013430.c.o(.text);
        build/src/func_80013438.c.o(.text);
        build/src/func_80013444.c.o(.text);
        build/src/func_80013450.c.o(.text);
        build/src/func_80013488.c.o(.text);
        build/src/func_800134B8.c.o(.text);
        build/src/func_800134C4.c.o(.text);
        build/src/func_80013668.c.o(.text);
        build/src/func_800136D4.c.o(.text);
        build/src/func_800139FC.c.o(.text);
        build/src/func_80013A24.c.o(.text);
        build/src/func_80013AA4.c.o(.text);
        build/src/func_80013AC8.c.o(.text);
        build/src/func_80013AEC.c.o(.text);
        build/src/func_80013AF8.c.o(.text);
        build/src/func_80013B04.c.o(.text);
        build/src/func_80013CD0.c.o(.text);
        build/src/func_80013F90.c.o(.text);
        build/src/func_80013FC0.c.o(.text);
        build/src/func_80014064.c.o(.text);
        build/src/func_800140C8.c.o(.text);
        build/src/func_8001413C.c.o(.text);
        build/src/func_80014250.c.o(.text);
        build/src/func_800142D8.c.o(.text);
        build/src/func_80014388.c.o(.text);
        build/src/func_80014494.c.o(.text);
        build/src/func_80014554.c.o(.text);
        build/src/func_800145F0.c.o(.text);
        build/src/func_80014748.c.o(.text);
        build/src/func_800147BC.c.o(.text);
        build/src/func_80014854.c.o(.text);
        build/src/func_80014988.c.o(.text);
        build/src/func_80014B38.c.o(.text);
        build/src/func_80014B44.c.o(.text);
        build/src/func_80014BCC.c.o(.text);
        build/src/func_80014CB0.c.o(.text);
        build/src/func_80014CBC.c.o(.text);
        build/src/func_80014E90.c.o(.text);
        build/src/func_80014F0C.c.o(.text);
        build/src/func_80014FAC.c.o(.text);
        build/src/func_80015074.c.o(.text);
        build/src/func_80015114.c.o(.text);
        build/src/func_800151B4.c.o(.text);
        build/src/func_8001526C.c.o(.text);
        build/src/func_8001530C.c.o(.text);
        build/src/func_800153BC.c.o(.text);
        build/src/func_800154CC.c.o(.text);
        build/src/func_80015594.c.o(.text);
        build/src/func_80015644.c.o(.text);
        build/src/func_80015704.c.o(.text);
        build/src/func_80015814.c.o(.text);
        build/src/func_80015828.c.o(.text);
        build/src/func_80015840.c.o(.text);
        build/src/func_8001585C.c.o(.text);
        build/src/func_80015868.c.o(.text);
        build/src/func_80015880.c.o(.text);
        build/src/func_8001588C.c.o(.text);
        build/src/func_80015894.c.o(.text);
        build/src/func_8001589C.c.o(.text);
        build/src/func_800158D8.c.o(.text);
        build/src/func_800158E4.c.o(.text);
        build/src/func_80015A18.c.o(.text);
        build/src/func_80015A34.c.o(.text);
        build/src/func_80015AA4.c.o(.text);
        build/src/func_80015AAC.c.o(.text);
        build/src/func_80015B1C.c.o(.text);
        build/src/func_80015B24.c.o(.text);
        build/src/func_80015BF0.c.o(.text);
        build/src/func_80015C50.c.o(.text);
        build/src/func_80015CA0.c.o(.text);
        build/src/func_80015D1C.c.o(.text);
        build/src/func_80015D6C.c.o(.text);
        build/src/func_80015DD4.c.o(.text);
        build/src/func_80015E3C.c.o(.text);
        build/src/func_80015E78.c.o(.text);
        build/src/func_80015EE8.c.o(.text);
        build/src/func_80015F80.c.o(.text);
        build/src/func_80016054.c.o(.text);
        build/src/func_800160C8.c.o(.text);
        build/src/func_800161AC.c.o(.text);
        build/src/func_80016280.c.o(.text);
        build/src/func_800165D8.c.o(.text);
        build/src/func_80016B7C.c.o(.text);
        build/src/func_80016C08.c.o(.text);
        build/src/func_8001719C.c.o(.text);
        build/src/func_800171CC.c.o(.text);
        build/src/func_80017200.c.o(.text);
        build/src/func_80017240.c.o(.text);
        build/src/func_80017284.c.o(.text);
        build/src/func_80017300.c.o(.text);
        build/src/func_8001782C.c.o(.text);
        build/src/func_800179E8.c.o(.text);
        build/src/func_80017A08.c.o(.text);
        build/src/func_80017A38.c.o(.text);
        build/src/func_80017A48.c.o(.text);
        build/src/func_80017A64.c.o(.text);
        build/src/func_80017A70.c.o(.text);
        build/src/func_80017AA0.c.o(.text);
        build/src/func_80017AC0.c.o(.text);
        build/src/func_80017AC4.c.o(.text);
        build/src/func_80017ACC.c.o(.text);
        build/src/func_80017AE8.c.o(.text);
        build/src/func_80017B18.c.o(.text);
        build/src/func_80017B24.c.o(.text);
        build/src/func_80017B30.c.o(.text);
        build/src/func_80017B3C.c.o(.text);
        build/src/func_80017BC8.c.o(.text);
        build/src/func_80017C04.c.o(.text);
        build/src/func_80017C24.c.o(.text);
        build/src/func_80017C30.c.o(.text);
        build/src/func_80017C3C.c.o(.text);
        build/src/func_80017C4C.c.o(.text);
        build/src/func_80017CF4.c.o(.text);
        build/src/func_80017D9C.c.o(.text);
        build/src/func_80017E34.c.o(.text);
        build/src/func_80017EA0.c.o(.text);
        build/src/func_80017EE4.c.o(.text);
        build/src/func_80017EEC.c.o(.text);
        build/src/func_80017EF0.c.o(.text);
        build/src/func_80017F10.c.o(.text);
        build/src/func_80017F28.c.o(.text);
        build/src/func_80017F30.c.o(.text);
        build/src/func_80017F88.c.o(.text);
        build/src/func_800183B8.c.o(.text);
        build/src/func_800183D0.c.o(.text);
        build/src/func_800183E0.c.o(.text);
        build/src/func_80018B8C.c.o(.text);
        build/src/func_80018B98.c.o(.text);
        build/src/func_80019030.c.o(.text);
        build/src/func_80019070.c.o(.text);
        build/src/func_800191B4.c.o(.text);
        build/src/func_8001929C.c.o(.text);
        build/src/func_800193F0.c.o(.text);
        build/src/func_8001945C.c.o(.text);
        build/src/func_80019564.c.o(.text);
        build/src/func_800195F4.c.o(.text);
        build/src/func_80019600.c.o(.text);
        build/src/func_80019610.c.o(.text);
        build/src/func_800197FC.c.o(.text);
        build/src/func_800198E0.c.o(.text);
        build/src/func_800199F8.c.o(.text);
        build/src/func_80019AD0.c.o(.text);
        build/src/func_80019CBC.c.o(.text);
        build/src/func_80019E14.c.o(.text);
        build/src/func_80019E50.c.o(.text);
        build/src/func_80019E80.c.o(.text);
        build/src/func_80019FAC.c.o(.text);
        build/src/func_80019FC4.c.o(.text);
        build/src/func_8001A018.c.o(.text);
        build/src/func_8001A11C.c.o(.text);
        build/src/func_8001A19C.c.o(.text);
        build/src/func_8001A284.c.o(.text);
        build/src/func_8001A574.c.o(.text);
        build/src/func_8001A668.c.o(.text);
        build/src/func_8001A6FC.c.o(.text);
        build/src/func_8001A790.c.o(.text);
        build/src/func_8001A808.c.o(.text);
        build/src/func_8001A870.c.o(.text);
        build/src/func_8001A8D0.c.o(.text);
        build/src/func_8001A8FC.c.o(.text);
        build/src/func_8001A910.c.o(.text);
        build/src/func_8001A940.c.o(.text);
        build/src/func_8001A948.c.o(.text);
        build/src/func_8001A950.c.o(.text);
        build/src/func_8001A958.c.o(.text);
        build/src/func_8001A960.c.o(.text);
        build/src/func_8001A968.c.o(.text);
        build/src/func_8001A970.c.o(.text);
        build/src/func_8001AA7C.c.o(.text);
        build/src/func_8001AAB8.c.o(.text);
        build/src/func_8001AAF4.c.o(.text);
        build/src/func_8001ABF0.c.o(.text);
        build/src/func_8001AC10.c.o(.text);
        build/src/func_8001ACA0.c.o(.text);
        build/src/func_8001ACBC.c.o(.text);
        build/src/func_8001AD00.c.o(.text);
        build/src/func_8001AD6C.c.o(.text);
        build/src/func_8001ADD8.c.o(.text);
        build/src/func_8001AE34.c.o(.text);
        build/src/func_8001AF34.c.o(.text);
        build/src/func_8001AF44.c.o(.text);
        build/src/func_8001AF70.c.o(.text);
        build/src/func_8001AFB0.c.o(.text);
        build/src/func_8001AFE0.c.o(.text);
        build/src/func_8001B028.c.o(.text);
        build/src/func_8001B074.c.o(.text);
        build/src/func_8001B100.c.o(.text);
        build/src/func_8001B10C.c.o(.text);
        build/src/func_8001B118.c.o(.text);
        build/src/func_8001B258.c.o(.text);
        build/src/func_8001B2CC.c.o(.text);
        build/src/func_8001B3CC.c.o(.text);
        build/src/func_8001B3EC.c.o(.text);
        build/src/func_8001B4D0.c.o(.text);
        build/src/func_8001B4E4.c.o(.text);
        build/src/func_8001B530.c.o(.text);
        build/src/func_8001B5DC.c.o(.text);
        build/src/func_8001B6A0.c.o(.text);
        build/src/func_8001B9F8.c.o(.text);
        build/src/func_8001BA18.c.o(.text);
        build/src/func_8001BA40.c.o(.text);
        build/src/func_8001BA5C.c.o(.text);
        build/src/func_8001BAC4.c.o(.text);
        build/src/func_8001BB28.c.o(.text);
        build/src/func_8001BB88.c.o(.text);
        build/src/func_8001BBD8.c.o(.text);
        build/src/func_8001BD64.c.o(.text);
        build/src/func_8001BE18.c.o(.text);
        build/src/func_8001BF74.c.o(.text);
        build/src/func_8001BF88.c.o(.text);
        build/src/func_8001BF9C.c.o(.text);
        build/src/func_8001BFA8.c.o(.text);
        build/src/func_8001BFD8.c.o(.text);
        build/src/func_8001BFE0.c.o(.text);
        build/src/func_8001BFEC.c.o(.text);
        build/src/func_8001C0D4.c.o(.text);
        build/src/func_8001C1C0.c.o(.text);
        build/src/func_8001C37C.c.o(.text);
        build/src/func_8001D21C.c.o(.text);
        build/src/func_8001D284.c.o(.text);
        build/src/func_8001D288.c.o(.text);
        build/src/func_8001D2A4.c.o(.text);
        build/src/func_8001D2D0.c.o(.text);
        build/src/func_8001D2D8.c.o(.text);
        build/src/func_8001D2F4.c.o(.text);
        build/src/func_8001D2FC.c.o(.text);
        build/src/func_8001D340.c.o(.text);
        build/src/func_8001D348.c.o(.text);
        build/src/func_8001D648.c.o(.text);
        build/src/func_8001D678.c.o(.text);
        build/src/func_8001D6AC.c.o(.text);
        build/src/func_8001D6B8.c.o(.text);
        build/src/func_8001D86C.c.o(.text);
        build/src/func_8001D884.c.o(.text);
        build/src/func_8001D8A0.c.o(.text);
        build/src/func_8001D8B8.c.o(.text);
        build/src/func_8001DBF0.c.o(.text);
        build/src/func_8001DCA8.c.o(.text);
        build/src/func_8001DCB0.c.o(.text);
        build/src/func_8001DE4C.c.o(.text);
        build/src/func_8001DFC8.c.o(.text);
        build/src/func_8001DFD4.c.o(.text);
        build/src/func_8001E04C.c.o(.text);
        build/src/func_8001E088.c.o(.text);
        build/src/func_8001E0B8.c.o(.text);
        build/src/func_8001E158.c.o(.text);
        build/src/func_8001E160.c.o(.text);
        build/src/func_8001E26C.c.o(.text);
        build/src/func_8001E334.c.o(.text);
        build/src/func_8001E340.c.o(.text);
        build/src/func_8001E38C.c.o(.text);
        build/src/func_8001E4C0.c.o(.text);
        build/src/func_8001E6FC.c.o(.text);
        build/src/func_8001E78C.c.o(.text);
        build/src/func_8001E7B8.c.o(.text);
        build/src/func_8001E7C0.c.o(.text);
        build/src/func_8001E7DC.c.o(.text);
        build/src/func_8001E818.c.o(.text);
        build/src/func_8001E820.c.o(.text);
        build/src/func_8001E878.c.o(.text);
        build/src/func_8001E9F8.c.o(.text);
        build/src/func_8001EAE4.c.o(.text);
        build/src/func_8001EF8C.c.o(.text);
        build/src/func_8001EF98.c.o(.text);
        build/src/func_8001EFA4.c.o(.text);
        build/src/func_8001F038.c.o(.text);
        build/src/func_8001F084.c.o(.text);
        build/src/func_8001F100.c.o(.text);
        build/src/func_8001F190.c.o(.text);
        build/src/func_8001F1B4.c.o(.text);
        build/src/func_8001F1C0.c.o(.text);
        build/src/func_8001F1E0.c.o(.text);
        build/src/func_8001F250.c.o(.text);
        build/src/func_8001F278.c.o(.text);
        build/src/func_8001F2EC.c.o(.text);
        build/src/func_8001F338.c.o(.text);
        build/src/func_8001F35C.c.o(.text);
        build/src/func_8001F39C.c.o(.text);
        build/src/func_8001F3DC.c.o(.text);
        build/src/func_8001F41C.c.o(.text);
        build/src/func_8001F424.c.o(.text);
        build/src/func_8001F42C.c.o(.text);
        build/src/func_8001F5B8.c.o(.text);
        build/src/func_8001F5EC.c.o(.text);
        build/src/func_8001F664.c.o(.text);
        build/src/func_8001F774.c.o(.text);
        build/src/func_8001F8A4.c.o(.text);
        build/src/func_8001FA0C.c.o(.text);
        build/src/func_8001FA98.c.o(.text);
        build/src/func_8001FAB4.c.o(.text);
        build/src/func_8001FABC.c.o(.text);
        build/src/func_8001FAE8.c.o(.text);
        build/src/func_8001FB08.c.o(.text);
        build/src/func_8001FB10.c.o(.text);
        build/src/func_8001FB30.c.o(.text);
        build/src/func_8001FBBC.c.o(.text);
        build/src/func_8001FBE4.c.o(.text);
        build/src/func_8001FBF0.c.o(.text);
        build/src/func_8001FCDC.c.o(.text);
        build/src/func_8001FCE4.c.o(.text);
        build/src/func_8001FD10.c.o(.text);
        build/src/func_8001FD74.c.o(.text);
        build/src/func_8001FD84.c.o(.text);
        build/src/func_8001FE00.c.o(.text);
        build/src/func_8001FE34.c.o(.text);
        build/src/func_8001FE6C.c.o(.text);
        build/src/func_8001FE7C.c.o(.text);
        build/src/func_8001FEA4.c.o(.text);
        build/src/func_8001FF70.c.o(.text);
        build/src/func_8001FF98.c.o(.text);
        build/src/func_800200E4.c.o(.text);
        build/src/func_80020148.c.o(.text);
        build/src/func_80020174.c.o(.text);
        build/src/func_800201C4.c.o(.text);
        build/src/func_8002029C.c.o(.text);
        build/src/func_800202F8.c.o(.text);
        build/src/func_8002039C.c.o(.text);
        build/src/func_8002040C.c.o(.text);
        build/src/func_80020414.c.o(.text);
        build/src/func_8002047C.c.o(.text);
        build/src/func_800204E0.c.o(.text);
        build/src/func_80020540.c.o(.text);
        build/src/func_80020570.c.o(.text);
        build/src/func_8002066C.c.o(.text);
        build/src/func_80020768.c.o(.text);
        build/src/func_80020790.c.o(.text);
        build/src/func_800207DC.c.o(.text);
        build/src/func_800207E4.c.o(.text);
        build/src/func_80020818.c.o(.text);
        build/src/func_80020900.c.o(.text);
        build/src/func_8002093C.c.o(.text);
        build/src/func_80020964.c.o(.text);
        build/src/func_8002098C.c.o(.text);
        build/src/func_800209B0.c.o(.text);
        build/src/func_800209D4.c.o(.text);
        build/src/func_800209F4.c.o(.text);
        build/src/func_80020A14.c.o(.text);
        build/src/func_80020A40.c.o(.text);
        build/src/func_80020A70.c.o(.text);
        build/src/func_80020A7C.c.o(.text);
        build/src/func_80020A88.c.o(.text);
        build/src/func_80020A94.c.o(.text);
        build/src/func_80020B80.c.o(.text);
        build/src/func_80020E38.c.o(.text);
        build/src/func_80020E58.c.o(.text);
        build/src/func_800212A8.c.o(.text);
        build/src/func_80021484.c.o(.text);
        build/src/func_800214FC.c.o(.text);
        build/src/func_800215EC.c.o(.text);
        build/src/func_80021604.c.o(.text);
        build/src/func_80021668.c.o(.text);
        build/src/func_800217B0.c.o(.text);
        build/src/func_80021818.c.o(.text);
        build/src/func_80021820.c.o(.text);
        build/src/func_80021844.c.o(.text);
        build/src/func_800218A8.c.o(.text);
        build/src/func_800218BC.c.o(.text);
        build/src/func_800218C4.c.o(.text);
        build/src/func_8002194C.c.o(.text);
        build/src/func_80021B20.c.o(.text);
        build/src/func_80021B64.c.o(.text);
        build/src/func_80021B84.c.o(.text);
        build/src/func_80021B88.c.o(.text);
        build/src/func_80021B90.c.o(.text);
        build/src/func_80021CD8.c.o(.text);
        build/src/func_80021D64.c.o(.text);
        build/src/func_80021D70.c.o(.text);
        build/src/func_80021D78.c.o(.text);
        build/src/func_80021D80.c.o(.text);
        build/src/func_80021D88.c.o(.text);
        build/src/func_80021D90.c.o(.text);
        build/src/func_80021D98.c.o(.text);
        build/src/func_80021DA0.c.o(.text);
        build/src/func_80021DA8.c.o(.text);
        build/src/func_80021E60.c.o(.text);
        build/src/func_80021FD0.c.o(.text);
        build/src/func_80021FE4.c.o(.text);
        build/src/func_80022008.c.o(.text);
        build/src/func_80022014.c.o(.text);
        build/src/func_80022028.c.o(.text);
        build/src/func_80022030.c.o(.text);
        build/src/func_80022048.c.o(.text);
        build/src/func_8002206C.c.o(.text);
        build/src/func_8002238C.c.o(.text);
        build/src/func_800223B0.c.o(.text);
        build/src/func_800223D4.c.o(.text);
        build/src/func_800224F0.c.o(.text);
        build/src/func_80022528.c.o(.text);
        build/src/func_80022580.c.o(.text);
        build/src/func_800225B8.c.o(.text);
        build/src/func_800225C4.c.o(.text);
        build/src/func_8002261C.c.o(.text);
        build/src/func_800226A4.c.o(.text);
        build/src/func_800226B0.c.o(.text);
        build/src/func_800226D8.c.o(.text);
        build/src/func_800226E4.c.o(.text);
        build/src/func_800226F0.c.o(.text);
        build/src/func_80022738.c.o(.text);
        build/src/func_80022788.c.o(.text);
        build/src/func_80022794.c.o(.text);
        build/src/func_80022964.c.o(.text);
        build/src/func_800229F4.c.o(.text);
        build/src/func_80022AF0.c.o(.text);
        build/src/func_80022B20.c.o(.text);
        build/src/func_80022B98.c.o(.text);
        build/src/func_80022D70.c.o(.text);
        build/src/func_80022DF8.c.o(.text);
        build/src/func_80022EA4.c.o(.text);
        build/src/func_80022F1C.c.o(.text);
        build/src/func_80022F80.c.o(.text);
        build/src/func_80022F90.c.o(.text);
        build/src/func_80022FA0.c.o(.text);
        build/src/func_80022FB4.c.o(.text);
        build/src/func_80022FD4.c.o(.text);
        build/src/func_80022FD8.c.o(.text);
        build/src/func_80022FE0.c.o(.text);
        build/src/func_8002301C.c.o(.text);
        build/src/func_80023030.c.o(.text);
        build/src/func_80023060.c.o(.text);
        build/src/func_80023100.c.o(.text);
        build/src/func_80023130.c.o(.text);
        build/src/func_80023170.c.o(.text);
        build/src/func_800231AC.c.o(.text);
        build/src/func_800231E8.c.o(.text);
        build/src/func_80023288.c.o(.text);
        build/src/func_800233B4.c.o(.text);
        build/src/func_8002348C.c.o(.text);
        build/src/func_80023600.c.o(.text);
        build/src/func_800236EC.c.o(.text);
        build/src/func_80023710.c.o(.text);
        build/src/func_8002374C.c.o(.text);
        build/src/func_80023774.c.o(.text);
        build/src/func_80023794.c.o(.text);
        build/src/func_800237FC.c.o(.text);
        build/src/func_80023910.c.o(.text);
        build/src/func_800239F8.c.o(.text);
        build/src/func_80023A74.c.o(.text);
        build/src/func_80023A9C.c.o(.text);
        build/src/func_80023B5C.c.o(.text);
        build/src/func_80023C2C.c.o(.text);
        build/src/func_80023CA4.c.o(.text);
        build/src/func_80023CE8.c.o(.text);
        build/src/func_80023D08.c.o(.text);
        build/src/func_80023DBC.c.o(.text);
        build/src/func_80024030.c.o(.text);
        build/src/func_80024108.c.o(.text);
        build/src/func_800241EC.c.o(.text);
        build/src/func_8002437C.c.o(.text);
        build/src/func_800243A4.c.o(.text);
        build/src/func_800243C0.c.o(.text);
        build/src/func_800243C8.c.o(.text);
        build/src/func_800243D0.c.o(.text);
        build/src/func_800243F8.c.o(.text);
        build/src/func_80024400.c.o(.text);
        build/src/func_80024408.c.o(.text);
        build/src/func_80024430.c.o(.text);
        build/src/func_80024434.c.o(.text);
        build/src/func_80024440.c.o(.text);
        build/src/func_80024448.c.o(.text);
        build/src/func_800244FC.c.o(.text);
        build/src/func_80024578.c.o(.text);
        build/src/func_800245C8.c.o(.text);
        build/src/func_800245F4.c.o(.text);
        build/src/func_8002462C.c.o(.text);
        build/src/func_80024664.c.o(.text);
        build/src/func_8002469C.c.o(.text);
        build/src/func_800246D4.c.o(.text);
        build/src/func_8002470C.c.o(.text);
        build/src/func_80024764.c.o(.text);
        build/src/func_80024770.c.o(.text);
        build/src/func_800247C0.c.o(.text);
        build/src/func_80024810.c.o(.text);
        build/src/func_80024860.c.o(.text);
        build/src/func_800248B0.c.o(.text);
        build/src/func_800248E8.c.o(.text);
        build/src/func_80024924.c.o(.text);
        build/src/func_8002495C.c.o(.text);
        build/src/func_800249B4.c.o(.text);
        build/src/func_800249C0.c.o(.text);
        build/src/func_80024A10.c.o(.text);
        build/src/func_80024A4C.c.o(.text);
        build/lib/libmath/adddf3.o(.text);
        build/lib/libmath/addmant.o(.text);
        build/lib/libmath/dbshift.o(.text);
        build/lib/libmath/fixdfsi.o(.text);
        build/lib/libmath/fltsidf.o(.text);
        build/lib/libmath/dbshiftu.o(.text);
        build/lib/libmath/ltdf2.o(.text);
        build/lib/libmath/mainasu.o(.text);
        build/lib/libmath/muldf3.o(.text);
        build/lib/libmath/ferr.o(.text);
        build/lib/libmath/sin00.o(.text);
        build/lib/libmath/divdf3.o(.text);
        build/lib/libmath/gedf2.o(.text);
        build/lib/libmath/eqdf2.o(.text);
        build/lib/libmath/negdf2.o(.text);
        build/lib/libmath/subdf3.o(.text);
        build/lib/libmath/sin01.o(.text);
        build/lib/libspu/s_gks.o(.text);
        build/lib/libspu/spu.o(.text);
        build/lib/libspu/s_ini.o(.text);
        build/lib/libspu/s_dcb.o(.text);
        build/lib/libspu/sr_gaks.o(.text);
        build/lib/libspu/s_sca.o(.text);
        build/lib/libsnd/ssclose.o(.text);
        build/lib/libsnd/ssend.o(.text);
        build/lib/libsnd/ssinit.o(.text);
        build/lib/libsnd/ssinit_c.o(.text);
        build/lib/libspu/s_i.o(.text);
        build/lib/libspu/s_crwa.o(.text);
        build/lib/libspu/s_m_util.o(.text);
        build/lib/libsnd/ssopenq.o(.text);
        build/lib/libsnd/cc_0.o(.text);
        build/lib/libsnd/cc_6.o(.text);
        build/lib/libsnd/cc_7.o(.text);
        build/lib/libsnd/cc_10.o(.text);
        build/lib/libsnd/cc_11.o(.text);
        build/lib/libsnd/cc_64.o(.text);
        build/lib/libsnd/cc_91.o(.text);
        build/lib/libsnd/cc_98.o(.text);
        build/lib/libsnd/cc_99.o(.text);
        build/lib/libsnd/cc_100.o(.text);
        build/lib/libsnd/cc_101.o(.text);
        build/lib/libsnd/cc_121.o(.text);
        build/lib/libsnd/de_0.o(.text);
        build/lib/libsnd/de_1.o(.text);
        build/lib/libsnd/de_2.o(.text);
        build/lib/libsnd/de_3.o(.text);
        build/lib/libsnd/de_4.o(.text);
        build/lib/libsnd/ccadsr.o(.text);
        build/lib/libsnd/de_5.o(.text);
        build/lib/libsnd/de_6.o(.text);
        build/lib/libsnd/de_7.o(.text);
        build/lib/libsnd/de_8.o(.text);
        build/lib/libsnd/de_9.o(.text);
        build/lib/libsnd/de_10.o(.text);
        build/lib/libsnd/de_11.o(.text);
        build/lib/libsnd/de_12.o(.text);
        build/lib/libsnd/de_13.o(.text);
        build/lib/libsnd/de_14.o(.text);
        build/lib/libsnd/de_15.o(.text);
        build/lib/libsnd/de_16.o(.text);
        build/lib/libsnd/de_17.o(.text);
        build/lib/libsnd/de_18.o(.text);
        build/lib/libsnd/de_19.o(.text);
        build/lib/libsnd/midibend.o(.text);
        build/lib/libsnd/midicc.o(.text);
        build/lib/libsnd/midimeta.o(.text);
        build/lib/libsnd/midinote.o(.text);
        build/lib/libsnd/midiprog.o(.text);
        build/lib/libsnd/miditime.o(.text);
        build/lib/libsnd/seqinit.o(.text);
        build/lib/libsnd/sspause.o(.text);
        build/lib/libsnd/ssplay.o(.text);
        build/lib/libsnd/ssreplay.o(.text);
        build/lib/libsnd/playmode.o(.text);
        build/lib/libsnd/sssattr.o(.text);
        build/lib/libsnd/sssmv.o(.text);
        build/lib/libsnd/sssrv.o(.text);
        build/lib/libspu/s_srd.o(.text);
        build/lib/libsnd/ssstart.o(.text);
        build/lib/libsnd/sscall.o(.text);
        build/lib/libsnd/cres.o(.text);
        build/lib/libsnd/pause.o(.text);
        build/lib/libsnd/play.o(.text);
        build/lib/libsnd/midiread.o(.text);
        build/lib/libsnd/next.o(.text);
        build/lib/libsnd/replay.o(.text);
        build/lib/libsnd/ssstop.o(.text);
        build/lib/libsnd/sssv.o(.text);
        build/lib/libsnd/sstable.o(.text);
        build/lib/libsnd/sstick.o(.text);
        build/lib/libsnd/ssvkoff.o(.text);
        build/lib/libsnd/ssvol.o(.text);
        build/lib/libsnd/tempo.o(.text);
        build/lib/libsnd/ut_ako.o(.text);
        build/lib/libspu/s_sva.o(.text);
        build/lib/libspu/s_n2p.o(.text);
        build/lib/libsnd/ut_gpa.o(.text);
        build/lib/libsnd/ut_gva.o(.text);
        build/lib/libsnd/ut_key.o(.text);
        build/lib/libsnd/ut_keyv.o(.text);
        build/lib/libsnd/ut_rdel.o(.text);
        build/lib/libspu/s_srmp.o(.text);
        build/lib/libspu/s_sra.o(.text);
        build/lib/libsnd/ut_rdep.o(.text);
        build/lib/libsnd/ut_rev.o(.text);
        build/lib/libspu/s_sr.o(.text);
        build/lib/libsnd/ut_rfb.o(.text);
        build/lib/libsnd/ut_roff.o(.text);
        build/lib/libsnd/ut_ron.o(.text);
        build/lib/libsnd/ut_sva.o(.text);
        build/lib/libsnd/ut_vvol4.o(.text);
        build/lib/libsnd/vm_aloc1.o(.text);
        build/lib/libsnd/vm_aloc2.o(.text);
        build/lib/libsnd/vm_doff.o(.text);
        build/lib/libsnd/vm_don.o(.text);
        build/lib/libsnd/vm_f.o(.text);
        build/lib/libspu/s_snv.o(.text);
        build/lib/libspu/s_sav.o(.text);
        build/lib/libspu/s_gnv.o(.text);
        build/lib/libspu/s_gav.o(.text);
        build/lib/libspu/s_srv.o(.text);
        build/lib/libspu/s_grv.o(.text);
        build/lib/libspu/s_sk.o(.text);
        build/lib/libspu/s_gvex.o(.text);
        build/lib/libsnd/vm_init.o(.text);
        build/lib/libspu/s_m_init.o(.text);
        build/lib/libspu/s_it.o(.text);
        build/lib/libsnd/vm_key.o(.text);
        build/lib/libsnd/vm_n2p.o(.text);
        build/lib/libsnd/vm_no1.o(.text);
        build/lib/libspu/s_snc.o(.text);
        build/lib/libsnd/vm_noff.o(.text);
        build/lib/libsnd/vm_nowof.o(.text);
        build/lib/libsnd/vm_nowon.o(.text);
        build/lib/libsnd/vm_pb.o(.text);
        build/lib/libsnd/vm_prog2.o(.text);
        build/lib/libsnd/vm_seq.o(.text);
        build/lib/libsnd/vm_stav.o(.text);
        build/lib/libsnd/vm_vol.o(.text);
        build/lib/libsnd/vm_vsu.o(.text);
        build/lib/libsnd/vs_mono.o(.text);
        build/lib/libsnd/vs_srv.o(.text);
        build/lib/libsnd/vs_vab.o(.text);
        build/lib/libspu/s_m_f.o(.text);
        build/lib/libspu/s_m_int.o(.text);
        build/lib/libsnd/vs_vh2.o(.text);
        build/lib/libspu/s_m_m.o(.text);
        build/lib/libsnd/vs_vh.o(.text);
        build/lib/libsnd/vs_vtbp.o(.text);
        build/lib/libspu/s_stsa.o(.text);
        build/lib/libspu/s_stm.o(.text);
        build/lib/libspu/s_wp.o(.text);
        build/lib/libsnd/vs_vtc.o(.text);
        build/lib/libspu/s_itc.o(.text);
        build/lib/libetc/vsync.o(.text);
        build/lib/libetc/intr.o(.text);
        build/lib/libetc/intr_vb.o(.text);
        build/lib/libetc/intr_dma.o(.text);
        build/lib/libetc/vmode.o(.text);
        build/lib/libcd/event.o(.text);
        build/lib/libcd/sys.o(.text);
        build/lib/libcd/iso9660.o(.text);
        build/lib/libcd/bios_1.o(.text);
        build/lib/libcd/s_002.o(.text);
        build/lib/libcd/s_005.o(.text);
        build/lib/libcd/s_008.o(.text);
        build/lib/libcd/s_012.o(.text);
        build/lib/libcd/s_016.o(.text);
        build/lib/libcd/cdr_1.o(.text);
        build/lib/libcd/s_003.o(.text);
        build/lib/libcd/s_004.o(.text);
        build/lib/libcd/s_006.o(.text);
        build/lib/libcd/s_013.o(.text);
        build/lib/libcd/s_014.o(.text);
        build/lib/libcd/s_015.o(.text);
        build/lib/libcd/s_021.o(.text);
        build/lib/libcd/bios_2.o(.text);
        build/lib/libcd/s_022.o(.text);
        build/lib/libcd/bios_3.o(.text);
        build/lib/libcd/s_023.o(.text);
        build/lib/libcd/s_024.o(.text);
        build/lib/libgte/geo_00.o(.text);
        build/lib/libgte/geo_01.o(.text);
        build/lib/libgte/fog_01.o(.text);
        build/lib/libgte/cor_02.o(.text);
        build/lib/libgte/cor_01.o(.text);
        build/lib/libgte/cor_03.o(.text);
        build/lib/libgte/cor_05.o(.text);
        build/lib/libgte/msc00.o(.text);
        build/lib/libgte/msc01.o(.text);
        build/lib/libgte/msc02.o(.text);
        build/lib/libgte/mtx_004.o(.text);
        build/lib/libgte/mtx_006.o(.text);
        build/lib/libgte/mtx_07.o(.text);
        build/lib/libgte/mtx_09.o(.text);
        build/lib/libgte/mtx_12.o(.text);
        build/lib/libgte/reg11.o(.text);
        build/lib/libgte/reg12.o(.text);
        build/lib/libgte/reg13.o(.text);
        build/lib/libgte/smp_04.o(.text);
        build/lib/libgte/fgo_01.o(.text);
        build/lib/libgte/fgo_04.o(.text);
        build/lib/libgte/fgo_05.o(.text);
        build/lib/libgte/fgo_06.o(.text);
        build/lib/libgte/fgo_08.o(.text);
        build/lib/libgte/ratan.o(.text);
        build/lib/libgte/patchgte.o(.text);
        build/lib/libgte/reg03_14.o(.text);
        build/lib/libgte/reg03_15.o(.text);
        build/src/func_80038674.c.o(.text);
        build/lib/libsnd/dmynot1.o(.text);
        build/lib/libgte/smp_00_1.o(.text);
        build/lib/libgs/gs_001.o(.text);
        build/lib/libgs/gs_0022.o(.text);
        build/lib/libgs/gs_003.o(.text);
        build/lib/libgs/gs_004.o(.text);
        build/lib/libgs/gs_103.o(.text);
        build/lib/libgs/gs_104.o(.text);
        build/lib/libgs/gs_106.o(.text);
        build/lib/libgs/gs_107.o(.text);
        build/lib/libgte/mtx_11.o(.text);
        build/lib/libgs/gs_108.o(.text);
        build/lib/libgs/gs_110.o(.text);
        build/lib/libgte/reg10.o(.text);
        build/lib/libgs/gs_121.o(.text);
        build/lib/libgs/gs_124.o(.text);
        build/lib/libgs/gs_125.o(.text);
        build/lib/libgpu/font.o(.text);
        build/lib/libgpu/kprintf.o(.text);
        build/lib/libgpu/sys.o(.text);
        build/lib/libgpu/e00.o(.text);
        build/lib/libgpu/e02.o(.text);
        build/lib/libgpu/e03.o(.text);
        build/lib/libgpu/e04.o(.text);
        build/lib/libgpu/p00.o(.text);
        build/lib/libgpu/p01.o(.text);
        build/lib/libgpu/p06.o(.text);
        build/lib/libgpu/p09.o(.text);
        build/lib/libgpu/p10.o(.text);
        build/lib/libgpu/p11.o(.text);
        build/lib/libgpu/p16.o(.text);
        build/lib/libgpu/p17.o(.text);
        build/lib/libgpu/p20.o(.text);
        build/lib/libgpu/p26.o(.text);
        build/lib/libgpu/p35.o(.text);
        build/lib/libgpu/p41.o(.text);
        build/lib/libgpu/kt01.o(.text);
        build/lib/libgpu/kt02.o(.text);
        build/lib/libmcrd/init.o(.text);
        build/lib/libapi/c112.o(.text);
        build/lib/libcard/init.o(.text);
        build/lib/libcard/a74.o(.text);
        build/lib/libcard/a75.o(.text);
        build/lib/libcard/a76.o(.text);
        build/lib/libcard/patch.o(.text);
        build/lib/libcard/end.o(.text);
        build/lib/libmcrd/libmcrd.o(.text);
        build/lib/libcard/c171.o(.text);
        build/lib/libcard/c172.o(.text);
        build/lib/libcard/card.o(.text);
        build/lib/libcard/a78.o(.text);
        build/lib/libcard/a80.o(.text);
        build/lib/libmcrd/userfunc.o(.text);
        build/lib/libmcrd/bios.o(.text);
        build/lib/libmcrd/low.o(.text);
        build/lib/libcard/a79.o(.text);
        build/lib/libmcrd/unformat.o(.text);
        build/lib/libc/a63.o(.text);
        build/lib/libc/c19.o(.text);
        build/lib/libc/c21.o(.text);
        build/lib/libc/c23.o(.text);
        build/lib/libc/c24.o(.text);
        build/lib/libc/c25.o(.text);
        build/lib/libc/c26.o(.text);
        build/lib/libc/c27.o(.text);
        build/lib/libc/c39.o(.text);
        build/lib/libc/c40.o(.text);
        build/lib/libc/c42.o(.text);
        build/lib/libc/c43.o(.text);
        build/lib/libc/c63.o(.text);
        build/lib/libc/sprintf.o(.text);
        build/lib/libc/c46.o(.text);
        build/lib/libc/memmove.o(.text);
        build/lib/libc/bcmp.o(.text);
        build/lib/libapi/c57.o(.text);
        build/lib/libapi/c68.o(.text);
        build/lib/libapi/c73.o(.text);
        build/lib/libapi/c114.o(.text);
        build/lib/libapi/c159.o(.text);
        build/lib/libapi/c161.o(.text);
        build/lib/libapi/a07.o(.text);
        build/lib/libapi/a08.o(.text);
        build/lib/libapi/a09.o(.text);
        build/lib/libapi/a10.o(.text);
        build/lib/libapi/a11.o(.text);
        build/lib/libapi/a12.o(.text);
        build/lib/libapi/a23.o(.text);
        build/lib/libapi/a24.o(.text);
        build/lib/libapi/a25.o(.text);
        build/lib/libapi/a36.o(.text);
        build/lib/libapi/a37.o(.text);
        build/lib/libapi/a50.o(.text);
        build/lib/libapi/a51.o(.text);
        build/lib/libapi/a52.o(.text);
        build/lib/libapi/a53.o(.text);
        build/lib/libapi/a54.o(.text);
        build/lib/libapi/a67.o(.text);
        build/lib/libapi/a68.o(.text);
        build/lib/libapi/a81.o(.text);
        build/lib/libapi/a91.o(.text);
        build/lib/libapi/l10.o(.text);
        build/lib/libapi/counter.o(.text);
        build/lib/libapi/first.o(.text);
        build/lib/libapi/a66.o(.text);
        build/lib/libapi/pad.o(.text);
        build/lib/libapi/a18.o(.text);
        build/lib/libapi/a19.o(.text);
        build/lib/libapi/a21.o(.text);
        build/lib/libapi/l02.o(.text);
        build/lib/libapi/l03.o(.text);
        build/lib/libapi/patch.o(.text);
        build/lib/libapi/chclrpad.o(.text);
        build/lib/libmcx/mcxcmd1.o(.text);
        build/lib/libmcx/mcxcmd2.o(.text);
        build/lib/libmcx/mcxcmd3.o(.text);
        build/lib/libmcx/mcxcmd4.o(.text);
        build/lib/libmcx/mcxcmd5.o(.text);
        build/lib/libmcx/mcxcmd6.o(.text);
        build/lib/libmcx/mcxcmd7.o(.text);
        build/lib/libmcx/mcxcmd8.o(.text);
        build/lib/libmcx/mcxcmd9.o(.text);
        build/lib/libmcx/mcxcmd10.o(.text);
        build/lib/libmcx/mcxcmd11.o(.text);
        build/lib/libmcx/mcxcmd12.o(.text);
        build/lib/libmcx/mcxcmd16.o(.text);
        build/lib/libmcx/mcxcmd17.o(.text);
        build/lib/libmcx/mcxcmd18.o(.text);
        build/lib/libmcx/mcxcmd19.o(.text);
        build/lib/libmcx/mcxcmd20.o(.text);
        build/lib/libmcx/mcxcmd21.o(.text);
        build/lib/libmcx/mcxcmd22.o(.text);
        build/lib/libmcx/mcxcmd23.o(.text);
        build/lib/libmcx/mcxcmd24.o(.text);
        build/lib/libmcx/mcxcmd25.o(.text);
        build/lib/libmcx/mcxcmd27.o(.text);
        build/lib/libmcx/mcxresi.o(.text);
        build/lib/libmcx/mcxinit.o(.text);
        build/lib/libmcx/mcxmain.o(.text);
        build/lib/libmcx/mcxdsr.o(.text);
        build/lib/libc/c28.o(.text);
        build/lib/libpad/pdcmd1.o(.text);
        build/lib/libpad/pdcmd2.o(.text);
        build/lib/libpad/pdent2.o(.text);
        build/lib/libpad/pdent3.o(.text);
        build/lib/libpad/pdmaiini.o(.text);
        build/lib/libpad/pddirini.o(.text);
        build/lib/libpad/pddirres.o(.text);
        build/lib/libpad/pdresres.o(.text);
        . = ALIGN(., 4);
        main_TEXT_END = .;
        main_TEXT_SIZE = ABSOLUTE(main_TEXT_END - main_TEXT_START);
        main_DATA_START = .;
        build/asm/data/800.rodata.s.o(.data);
        build/src/func_80011270.c.o(.data);
        build/src/__start.c.o(.data);
        build/src/func_80011370.c.o(.data);
        build/src/func_80011C24.c.o(.data);
        build/src/func_80011DB0.c.o(.data);
        build/src/func_80011EE8.c.o(.data);
        build/src/func_80011EF0.c.o(.data);
        build/src/func_80011F08.c.o(.data);
        build/src/func_80011F14.c.o(.data);
        build/src/func_80011F20.c.o(.data);
        build/src/func_80011F2C.c.o(.data);
        build/src/func_80011F38.c.o(.data);
        build/src/func_80011F44.c.o(.data);
        build/src/func_80011F50.c.o(.data);
        build/src/func_80011F5C.c.o(.data);
        build/src/func_80011FD8.c.o(.data);
        build/src/func_8001202C.c.o(.data);
        build/src/func_8001205C.c.o(.data);
        build/src/func_80012098.c.o(.data);
        build/src/func_800120BC.c.o(.data);
        build/src/func_800120C8.c.o(.data);
        build/src/func_800121D4.c.o(.data);
        build/src/func_80012298.c.o(.data);
        build/src/func_8001231C.c.o(.data);
        build/src/func_80012598.c.o(.data);
        build/src/func_800128DC.c.o(.data);
        build/src/func_800129E8.c.o(.data);
        build/src/func_800129F4.c.o(.data);
        build/src/func_80012A14.c.o(.data);
        build/src/func_80012A34.c.o(.data);
        build/src/func_80012A68.c.o(.data);
        build/src/func_80012AB0.c.o(.data);
        build/src/func_80012CB4.c.o(.data);
        build/src/func_80012D30.c.o(.data);
        build/src/func_8001316C.c.o(.data);
        build/src/func_8001328C.c.o(.data);
        build/src/func_800132B8.c.o(.data);
        build/src/func_800132F0.c.o(.data);
        build/src/func_80013328.c.o(.data);
        build/src/func_80013394.c.o(.data);
        build/src/func_800133B0.c.o(.data);
        build/src/func_800133D4.c.o(.data);
        build/src/func_800133E8.c.o(.data);
        build/src/func_80013400.c.o(.data);
        build/src/func_80013428.c.o(.data);
        build/src/func_80013430.c.o(.data);
        build/src/func_80013438.c.o(.data);
        build/src/func_80013444.c.o(.data);
        build/src/func_80013450.c.o(.data);
        build/src/func_80013488.c.o(.data);
        build/src/func_800134B8.c.o(.data);
        build/src/func_800134C4.c.o(.data);
        build/src/func_80013668.c.o(.data);
        build/src/func_800136D4.c.o(.data);
        build/src/func_800139FC.c.o(.data);
        build/src/func_80013A24.c.o(.data);
        build/src/func_80013AA4.c.o(.data);
        build/src/func_80013AC8.c.o(.data);
        build/src/func_80013AEC.c.o(.data);
        build/src/func_80013AF8.c.o(.data);
        build/src/func_80013B04.c.o(.data);
        build/src/func_80013CD0.c.o(.data);
        build/src/func_80013F90.c.o(.data);
        build/src/func_80013FC0.c.o(.data);
        build/src/func_80014064.c.o(.data);
        build/src/func_800140C8.c.o(.data);
        build/src/func_8001413C.c.o(.data);
        build/src/func_80014250.c.o(.data);
        build/src/func_800142D8.c.o(.data);
        build/src/func_80014388.c.o(.data);
        build/src/func_80014494.c.o(.data);
        build/src/func_80014554.c.o(.data);
        build/src/func_800145F0.c.o(.data);
        build/src/func_80014748.c.o(.data);
        build/src/func_800147BC.c.o(.data);
        build/src/func_80014854.c.o(.data);
        build/src/func_80014988.c.o(.data);
        build/src/func_80014B38.c.o(.data);
        build/src/func_80014B44.c.o(.data);
        build/src/func_80014BCC.c.o(.data);
        build/src/func_80014CB0.c.o(.data);
        build/src/func_80014CBC.c.o(.data);
        build/src/func_80014E90.c.o(.data);
        build/src/func_80014F0C.c.o(.data);
        build/src/func_80014FAC.c.o(.data);
        build/src/func_80015074.c.o(.data);
        build/src/func_80015114.c.o(.data);
        build/src/func_800151B4.c.o(.data);
        build/src/func_8001526C.c.o(.data);
        build/src/func_8001530C.c.o(.data);
        build/src/func_800153BC.c.o(.data);
        build/src/func_800154CC.c.o(.data);
        build/src/func_80015594.c.o(.data);
        build/src/func_80015644.c.o(.data);
        build/src/func_80015704.c.o(.data);
        build/src/func_80015814.c.o(.data);
        build/src/func_80015828.c.o(.data);
        build/src/func_80015840.c.o(.data);
        build/src/func_8001585C.c.o(.data);
        build/src/func_80015868.c.o(.data);
        build/src/func_80015880.c.o(.data);
        build/src/func_8001588C.c.o(.data);
        build/src/func_80015894.c.o(.data);
        build/src/func_8001589C.c.o(.data);
        build/src/func_800158D8.c.o(.data);
        build/src/func_800158E4.c.o(.data);
        build/src/func_80015A18.c.o(.data);
        build/src/func_80015A34.c.o(.data);
        build/src/func_80015AA4.c.o(.data);
        build/src/func_80015AAC.c.o(.data);
        build/src/func_80015B1C.c.o(.data);
        build/src/func_80015B24.c.o(.data);
        build/src/func_80015BF0.c.o(.data);
        build/src/func_80015C50.c.o(.data);
        build/src/func_80015CA0.c.o(.data);
        build/src/func_80015D1C.c.o(.data);
        build/src/func_80015D6C.c.o(.data);
        build/src/func_80015DD4.c.o(.data);
        build/src/func_80015E3C.c.o(.data);
        build/src/func_80015E78.c.o(.data);
        build/src/func_80015EE8.c.o(.data);
        build/src/func_80015F80.c.o(.data);
        build/src/func_80016054.c.o(.data);
        build/src/func_800160C8.c.o(.data);
        build/src/func_800161AC.c.o(.data);
        build/src/func_80016280.c.o(.data);
        build/src/func_800165D8.c.o(.data);
        build/src/func_80016B7C.c.o(.data);
        build/src/func_80016C08.c.o(.data);
        build/src/func_8001719C.c.o(.data);
        build/src/func_800171CC.c.o(.data);
        build/src/func_80017200.c.o(.data);
        build/src/func_80017240.c.o(.data);
        build/src/func_80017284.c.o(.data);
        build/src/func_80017300.c.o(.data);
        build/src/func_8001782C.c.o(.data);
        build/src/func_800179E8.c.o(.data);
        build/src/func_80017A08.c.o(.data);
        build/src/func_80017A38.c.o(.data);
        build/src/func_80017A48.c.o(.data);
        build/src/func_80017A64.c.o(.data);
        build/src/func_80017A70.c.o(.data);
        build/src/func_80017AA0.c.o(.data);
        build/src/func_80017AC0.c.o(.data);
        build/src/func_80017AC4.c.o(.data);
        build/src/func_80017ACC.c.o(.data);
        build/src/func_80017AE8.c.o(.data);
        build/src/func_80017B18.c.o(.data);
        build/src/func_80017B24.c.o(.data);
        build/src/func_80017B30.c.o(.data);
        build/src/func_80017B3C.c.o(.data);
        build/src/func_80017BC8.c.o(.data);
        build/src/func_80017C04.c.o(.data);
        build/src/func_80017C24.c.o(.data);
        build/src/func_80017C30.c.o(.data);
        build/src/func_80017C3C.c.o(.data);
        build/src/func_80017C4C.c.o(.data);
        build/src/func_80017CF4.c.o(.data);
        build/src/func_80017D9C.c.o(.data);
        build/src/func_80017E34.c.o(.data);
        build/src/func_80017EA0.c.o(.data);
        build/src/func_80017EE4.c.o(.data);
        build/src/func_80017EEC.c.o(.data);
        build/src/func_80017EF0.c.o(.data);
        build/src/func_80017F10.c.o(.data);
        build/src/func_80017F28.c.o(.data);
        build/src/func_80017F30.c.o(.data);
        build/src/func_80017F88.c.o(.data);
        build/src/func_800183B8.c.o(.data);
        build/src/func_800183D0.c.o(.data);
        build/src/func_800183E0.c.o(.data);
        build/src/func_80018B8C.c.o(.data);
        build/src/func_80018B98.c.o(.data);
        build/src/func_80019030.c.o(.data);
        build/src/func_80019070.c.o(.data);
        build/src/func_800191B4.c.o(.data);
        build/src/func_8001929C.c.o(.data);
        build/src/func_800193F0.c.o(.data);
        build/src/func_8001945C.c.o(.data);
        build/src/func_80019564.c.o(.data);
        build/src/func_800195F4.c.o(.data);
        build/src/func_80019600.c.o(.data);
        build/src/func_80019610.c.o(.data);
        build/src/func_800197FC.c.o(.data);
        build/src/func_800198E0.c.o(.data);
        build/src/func_800199F8.c.o(.data);
        build/src/func_80019AD0.c.o(.data);
        build/src/func_80019CBC.c.o(.data);
        build/src/func_80019E14.c.o(.data);
        build/src/func_80019E50.c.o(.data);
        build/src/func_80019E80.c.o(.data);
        build/src/func_80019FAC.c.o(.data);
        build/src/func_80019FC4.c.o(.data);
        build/src/func_8001A018.c.o(.data);
        build/src/func_8001A11C.c.o(.data);
        build/src/func_8001A19C.c.o(.data);
        build/src/func_8001A284.c.o(.data);
        build/src/func_8001A574.c.o(.data);
        build/src/func_8001A668.c.o(.data);
        build/src/func_8001A6FC.c.o(.data);
        build/src/func_8001A790.c.o(.data);
        build/src/func_8001A808.c.o(.data);
        build/src/func_8001A870.c.o(.data);
        build/src/func_8001A8D0.c.o(.data);
        build/src/func_8001A8FC.c.o(.data);
        build/src/func_8001A910.c.o(.data);
        build/src/func_8001A940.c.o(.data);
        build/src/func_8001A948.c.o(.data);
        build/src/func_8001A950.c.o(.data);
        build/src/func_8001A958.c.o(.data);
        build/src/func_8001A960.c.o(.data);
        build/src/func_8001A968.c.o(.data);
        build/src/func_8001A970.c.o(.data);
        build/src/func_8001AA7C.c.o(.data);
        build/src/func_8001AAB8.c.o(.data);
        build/src/func_8001AAF4.c.o(.data);
        build/src/func_8001ABF0.c.o(.data);
        build/src/func_8001AC10.c.o(.data);
        build/src/func_8001ACA0.c.o(.data);
        build/src/func_8001ACBC.c.o(.data);
        build/src/func_8001AD00.c.o(.data);
        build/src/func_8001AD6C.c.o(.data);
        build/src/func_8001ADD8.c.o(.data);
        build/src/func_8001AE34.c.o(.data);
        build/src/func_8001AF34.c.o(.data);
        build/src/func_8001AF44.c.o(.data);
        build/src/func_8001AF70.c.o(.data);
        build/src/func_8001AFB0.c.o(.data);
        build/src/func_8001AFE0.c.o(.data);
        build/src/func_8001B028.c.o(.data);
        build/src/func_8001B074.c.o(.data);
        build/src/func_8001B100.c.o(.data);
        build/src/func_8001B10C.c.o(.data);
        build/src/func_8001B118.c.o(.data);
        build/src/func_8001B258.c.o(.data);
        build/src/func_8001B2CC.c.o(.data);
        build/src/func_8001B3CC.c.o(.data);
        build/src/func_8001B3EC.c.o(.data);
        build/src/func_8001B4D0.c.o(.data);
        build/src/func_8001B4E4.c.o(.data);
        build/src/func_8001B530.c.o(.data);
        build/src/func_8001B5DC.c.o(.data);
        build/src/func_8001B6A0.c.o(.data);
        build/src/func_8001B9F8.c.o(.data);
        build/src/func_8001BA18.c.o(.data);
        build/src/func_8001BA40.c.o(.data);
        build/src/func_8001BA5C.c.o(.data);
        build/src/func_8001BAC4.c.o(.data);
        build/src/func_8001BB28.c.o(.data);
        build/src/func_8001BB88.c.o(.data);
        build/src/func_8001BBD8.c.o(.data);
        build/src/func_8001BD64.c.o(.data);
        build/src/func_8001BE18.c.o(.data);
        build/src/func_8001BF74.c.o(.data);
        build/src/func_8001BF88.c.o(.data);
        build/src/func_8001BF9C.c.o(.data);
        build/src/func_8001BFA8.c.o(.data);
        build/src/func_8001BFD8.c.o(.data);
        build/src/func_8001BFE0.c.o(.data);
        build/src/func_8001BFEC.c.o(.data);
        build/src/func_8001C0D4.c.o(.data);
        build/src/func_8001C1C0.c.o(.data);
        build/src/func_8001C37C.c.o(.data);
        build/src/func_8001D21C.c.o(.data);
        build/src/func_8001D284.c.o(.data);
        build/src/func_8001D288.c.o(.data);
        build/src/func_8001D2A4.c.o(.data);
        build/src/func_8001D2D0.c.o(.data);
        build/src/func_8001D2D8.c.o(.data);
        build/src/func_8001D2F4.c.o(.data);
        build/src/func_8001D2FC.c.o(.data);
        build/src/func_8001D340.c.o(.data);
        build/src/func_8001D348.c.o(.data);
        build/src/func_8001D648.c.o(.data);
        build/src/func_8001D678.c.o(.data);
        build/src/func_8001D6AC.c.o(.data);
        build/src/func_8001D6B8.c.o(.data);
        build/src/func_8001D86C.c.o(.data);
        build/src/func_8001D884.c.o(.data);
        build/src/func_8001D8A0.c.o(.data);
        build/src/func_8001D8B8.c.o(.data);
        build/src/func_8001DBF0.c.o(.data);
        build/src/func_8001DCA8.c.o(.data);
        build/src/func_8001DCB0.c.o(.data);
        build/src/func_8001DE4C.c.o(.data);
        build/src/func_8001DFC8.c.o(.data);
        build/src/func_8001DFD4.c.o(.data);
        build/src/func_8001E04C.c.o(.data);
        build/src/func_8001E088.c.o(.data);
        build/src/func_8001E0B8.c.o(.data);
        build/src/func_8001E158.c.o(.data);
        build/src/func_8001E160.c.o(.data);
        build/src/func_8001E26C.c.o(.data);
        build/src/func_8001E334.c.o(.data);
        build/src/func_8001E340.c.o(.data);
        build/src/func_8001E38C.c.o(.data);
        build/src/func_8001E4C0.c.o(.data);
        build/src/func_8001E6FC.c.o(.data);
        build/src/func_8001E78C.c.o(.data);
        build/src/func_8001E7B8.c.o(.data);
        build/src/func_8001E7C0.c.o(.data);
        build/src/func_8001E7DC.c.o(.data);
        build/src/func_8001E818.c.o(.data);
        build/src/func_8001E820.c.o(.data);
        build/src/func_8001E878.c.o(.data);
        build/src/func_8001E9F8.c.o(.data);
        build/src/func_8001EAE4.c.o(.data);
        build/src/func_8001EF8C.c.o(.data);
        build/src/func_8001EF98.c.o(.data);
        build/src/func_8001EFA4.c.o(.data);
        build/src/func_8001F038.c.o(.data);
        build/src/func_8001F084.c.o(.data);
        build/src/func_8001F100.c.o(.data);
        build/src/func_8001F190.c.o(.data);
        build/src/func_8001F1B4.c.o(.data);
        build/src/func_8001F1C0.c.o(.data);
        build/src/func_8001F1E0.c.o(.data);
        build/src/func_8001F250.c.o(.data);
        build/src/func_8001F278.c.o(.data);
        build/src/func_8001F2EC.c.o(.data);
        build/src/func_8001F338.c.o(.data);
        build/src/func_8001F35C.c.o(.data);
        build/src/func_8001F39C.c.o(.data);
        build/src/func_8001F3DC.c.o(.data);
        build/src/func_8001F41C.c.o(.data);
        build/src/func_8001F424.c.o(.data);
        build/src/func_8001F42C.c.o(.data);
        build/src/func_8001F5B8.c.o(.data);
        build/src/func_8001F5EC.c.o(.data);
        build/src/func_8001F664.c.o(.data);
        build/src/func_8001F774.c.o(.data);
        build/src/func_8001F8A4.c.o(.data);
        build/src/func_8001FA0C.c.o(.data);
        build/src/func_8001FA98.c.o(.data);
        build/src/func_8001FAB4.c.o(.data);
        build/src/func_8001FABC.c.o(.data);
        build/src/func_8001FAE8.c.o(.data);
        build/src/func_8001FB08.c.o(.data);
        build/src/func_8001FB10.c.o(.data);
        build/src/func_8001FB30.c.o(.data);
        build/src/func_8001FBBC.c.o(.data);
        build/src/func_8001FBE4.c.o(.data);
        build/src/func_8001FBF0.c.o(.data);
        build/src/func_8001FCDC.c.o(.data);
        build/src/func_8001FCE4.c.o(.data);
        build/src/func_8001FD10.c.o(.data);
        build/src/func_8001FD74.c.o(.data);
        build/src/func_8001FD84.c.o(.data);
        build/src/func_8001FE00.c.o(.data);
        build/src/func_8001FE34.c.o(.data);
        build/src/func_8001FE6C.c.o(.data);
        build/src/func_8001FE7C.c.o(.data);
        build/src/func_8001FEA4.c.o(.data);
        build/src/func_8001FF70.c.o(.data);
        build/src/func_8001FF98.c.o(.data);
        build/src/func_800200E4.c.o(.data);
        build/src/func_80020148.c.o(.data);
        build/src/func_80020174.c.o(.data);
        build/src/func_800201C4.c.o(.data);
        build/src/func_8002029C.c.o(.data);
        build/src/func_800202F8.c.o(.data);
        build/src/func_8002039C.c.o(.data);
        build/src/func_8002040C.c.o(.data);
        build/src/func_80020414.c.o(.data);
        build/src/func_8002047C.c.o(.data);
        build/src/func_800204E0.c.o(.data);
        build/src/func_80020540.c.o(.data);
        build/src/func_80020570.c.o(.data);
        build/src/func_8002066C.c.o(.data);
        build/src/func_80020768.c.o(.data);
        build/src/func_80020790.c.o(.data);
        build/src/func_800207DC.c.o(.data);
        build/src/func_800207E4.c.o(.data);
        build/src/func_80020818.c.o(.data);
        build/src/func_80020900.c.o(.data);
        build/src/func_8002093C.c.o(.data);
        build/src/func_80020964.c.o(.data);
        build/src/func_8002098C.c.o(.data);
        build/src/func_800209B0.c.o(.data);
        build/src/func_800209D4.c.o(.data);
        build/src/func_800209F4.c.o(.data);
        build/src/func_80020A14.c.o(.data);
        build/src/func_80020A40.c.o(.data);
        build/src/func_80020A70.c.o(.data);
        build/src/func_80020A7C.c.o(.data);
        build/src/func_80020A88.c.o(.data);
        build/src/func_80020A94.c.o(.data);
        build/src/func_80020B80.c.o(.data);
        build/src/func_80020E38.c.o(.data);
        build/src/func_80020E58.c.o(.data);
        build/src/func_800212A8.c.o(.data);
        build/src/func_80021484.c.o(.data);
        build/src/func_800214FC.c.o(.data);
        build/src/func_800215EC.c.o(.data);
        build/src/func_80021604.c.o(.data);
        build/src/func_80021668.c.o(.data);
        build/src/func_800217B0.c.o(.data);
        build/src/func_80021818.c.o(.data);
        build/src/func_80021820.c.o(.data);
        build/src/func_80021844.c.o(.data);
        build/src/func_800218A8.c.o(.data);
        build/src/func_800218BC.c.o(.data);
        build/src/func_800218C4.c.o(.data);
        build/src/func_8002194C.c.o(.data);
        build/src/func_80021B20.c.o(.data);
        build/src/func_80021B64.c.o(.data);
        build/src/func_80021B84.c.o(.data);
        build/src/func_80021B88.c.o(.data);
        build/src/func_80021B90.c.o(.data);
        build/src/func_80021CD8.c.o(.data);
        build/src/func_80021D64.c.o(.data);
        build/src/func_80021D70.c.o(.data);
        build/src/func_80021D78.c.o(.data);
        build/src/func_80021D80.c.o(.data);
        build/src/func_80021D88.c.o(.data);
        build/src/func_80021D90.c.o(.data);
        build/src/func_80021D98.c.o(.data);
        build/src/func_80021DA0.c.o(.data);
        build/src/func_80021DA8.c.o(.data);
        build/src/func_80021E60.c.o(.data);
        build/src/func_80021FD0.c.o(.data);
        build/src/func_80021FE4.c.o(.data);
        build/src/func_80022008.c.o(.data);
        build/src/func_80022014.c.o(.data);
        build/src/func_80022028.c.o(.data);
        build/src/func_80022030.c.o(.data);
        build/src/func_80022048.c.o(.data);
        build/src/func_8002206C.c.o(.data);
        build/src/func_8002238C.c.o(.data);
        build/src/func_800223B0.c.o(.data);
        build/src/func_800223D4.c.o(.data);
        build/src/func_800224F0.c.o(.data);
        build/src/func_80022528.c.o(.data);
        build/src/func_80022580.c.o(.data);
        build/src/func_800225B8.c.o(.data);
        build/src/func_800225C4.c.o(.data);
        build/src/func_8002261C.c.o(.data);
        build/src/func_800226A4.c.o(.data);
        build/src/func_800226B0.c.o(.data);
        build/src/func_800226D8.c.o(.data);
        build/src/func_800226E4.c.o(.data);
        build/src/func_800226F0.c.o(.data);
        build/src/func_80022738.c.o(.data);
        build/src/func_80022788.c.o(.data);
        build/src/func_80022794.c.o(.data);
        build/src/func_80022964.c.o(.data);
        build/src/func_800229F4.c.o(.data);
        build/src/func_80022AF0.c.o(.data);
        build/src/func_80022B20.c.o(.data);
        build/src/func_80022B98.c.o(.data);
        build/src/func_80022D70.c.o(.data);
        build/src/func_80022DF8.c.o(.data);
        build/src/func_80022EA4.c.o(.data);
        build/src/func_80022F1C.c.o(.data);
        build/src/func_80022F80.c.o(.data);
        build/src/func_80022F90.c.o(.data);
        build/src/func_80022FA0.c.o(.data);
        build/src/func_80022FB4.c.o(.data);
        build/src/func_80022FD4.c.o(.data);
        build/src/func_80022FD8.c.o(.data);
        build/src/func_80022FE0.c.o(.data);
        build/src/func_8002301C.c.o(.data);
        build/src/func_80023030.c.o(.data);
        build/src/func_80023060.c.o(.data);
        build/src/func_80023100.c.o(.data);
        build/src/func_80023130.c.o(.data);
        build/src/func_80023170.c.o(.data);
        build/src/func_800231AC.c.o(.data);
        build/src/func_800231E8.c.o(.data);
        build/src/func_80023288.c.o(.data);
        build/src/func_800233B4.c.o(.data);
        build/src/func_8002348C.c.o(.data);
        build/src/func_80023600.c.o(.data);
        build/src/func_800236EC.c.o(.data);
        build/src/func_80023710.c.o(.data);
        build/src/func_8002374C.c.o(.data);
        build/src/func_80023774.c.o(.data);
        build/src/func_80023794.c.o(.data);
        build/src/func_800237FC.c.o(.data);
        build/src/func_80023910.c.o(.data);
        build/src/func_800239F8.c.o(.data);
        build/src/func_80023A74.c.o(.data);
        build/src/func_80023A9C.c.o(.data);
        build/src/func_80023B5C.c.o(.data);
        build/src/func_80023C2C.c.o(.data);
        build/src/func_80023CA4.c.o(.data);
        build/src/func_80023CE8.c.o(.data);
        build/src/func_80023D08.c.o(.data);
        build/src/func_80023DBC.c.o(.data);
        build/src/func_80024030.c.o(.data);
        build/src/func_80024108.c.o(.data);
        build/src/func_800241EC.c.o(.data);
        build/src/func_8002437C.c.o(.data);
        build/src/func_800243A4.c.o(.data);
        build/src/func_800243C0.c.o(.data);
        build/src/func_800243C8.c.o(.data);
        build/src/func_800243D0.c.o(.data);
        build/src/func_800243F8.c.o(.data);
        build/src/func_80024400.c.o(.data);
        build/src/func_80024408.c.o(.data);
        build/src/func_80024430.c.o(.data);
        build/src/func_80024434.c.o(.data);
        build/src/func_80024440.c.o(.data);
        build/src/func_80024448.c.o(.data);
        build/src/func_800244FC.c.o(.data);
        build/src/func_80024578.c.o(.data);
        build/src/func_800245C8.c.o(.data);
        build/src/func_800245F4.c.o(.data);
        build/src/func_8002462C.c.o(.data);
        build/src/func_80024664.c.o(.data);
        build/src/func_8002469C.c.o(.data);
        build/src/func_800246D4.c.o(.data);
        build/src/func_8002470C.c.o(.data);
        build/src/func_80024764.c.o(.data);
        build/src/func_80024770.c.o(.data);
        build/src/func_800247C0.c.o(.data);
        build/src/func_80024810.c.o(.data);
        build/src/func_80024860.c.o(.data);
        build/src/func_800248B0.c.o(.data);
        build/src/func_800248E8.c.o(.data);
        build/src/func_80024924.c.o(.data);
        build/src/func_8002495C.c.o(.data);
        build/src/func_800249B4.c.o(.data);
        build/src/func_800249C0.c.o(.data);
        build/src/func_80024A10.c.o(.data);
        build/src/func_80024A4C.c.o(.data);
        build/src/func_80038674.c.o(.data);
        build/asm/data/39314.data.s.o(.data);
        build/lib/libmath/ferr.o(.data);
        build/lib/libspu/spu.o(.data);
        build/lib/libspu/s_ini.o(.data);
        build/asm/data/462FC.data.s.o(.data);
        build/lib/libsnd/ssinit.o(.data);
        build/asm/data/4636C.data.s.o(.data);
        build/lib/libsnd/ssstart.o(.data);
        build/lib/libspu/s_n2p.o(.data);
        build/asm/data/468AC.data.s.o(.data);
        build/lib/libsnd/vm_n2p.o(.data);
        build/lib/libsnd/vs_vtbp.o(.data);
        build/asm/data/46C8C.data.s.o(.data);
        build/lib/libetc/vsync.o(.data);
        build/lib/libetc/intr.o(.data);
        build/lib/libetc/intr_vb.o(.data);
        build/lib/libetc/intr_dma.o(.data);
        build/lib/libetc/vmode.o(.data);
        build/lib/libcd/event.o(.data);
        build/lib/libcd/iso9660.o(.data);
        build/lib/libcd/bios_1.o(.data);
        build/lib/libcd/s_016.o(.data);
        build/lib/libcd/cdr_1.o(.data);
        build/lib/libcd/bios_2.o(.data);
        build/lib/libcd/bios_3.o(.data);
        build/asm/data/48254.data.s.o(.data);
        build/lib/libgte/cor_01.o(.data);
        build/lib/libgte/msc00.o(.data);
        build/asm/data/48A94.data.s.o(.data);
        build/lib/libgte/msc02.o(.data);
        build/lib/libgte/mtx_006.o(.data);
        build/asm/data/490C4.data.s.o(.data);
        build/lib/libgte/ratan.o(.data);
        build/lib/libgs/gs_001.o(.data);
        build/asm/data/4D8E4.data.s.o(.data);
        build/lib/libgpu/font.o(.data);
        build/lib/libgpu/kprintf.o(.data);
        build/lib/libgpu/sys.o(.data);
        build/lib/libgpu/kt01.o(.data);
        build/lib/libgpu/kt02.o(.data);
        . = ALIGN(., 4);
        main_DATA_END = .;
        main_DATA_SIZE = ABSOLUTE(main_DATA_END - main_DATA_START);
        main_SDATA_START = .;
        build/asm/data/4E7D4.sdata.s.o(.sdata);
        build/lib/libmcrd/libmcrd.o(.data);
        build/lib/libmcrd/userfunc.o(.data);
        build/asm/data/4E824.sdata.s.o(.sdata);
        build/lib/libc/sprintf.o(.data);
        build/lib/libapi/counter.o(.data);
        build/lib/libapi/pad.o(.data);
        build/lib/libmcx/mcxcmd10.o(.data);
        build/lib/libmcx/mcxcmd12.o(.data);
        build/lib/libmcx/mcxresi.o(.data);
        build/lib/libmcx/mcxinit.o(.data);
        build/lib/libmcx/mcxmain.o(.data);
        build/lib/libmcx/mcxdsr.o(.data);
        build/lib/libpad/pdmaiini.o(.data);
        build/lib/libpad/pddirres.o(.data);
        build/lib/libpad/pdresres.o(.data);
        build/asm/data/4EA74.sdata.s.o(.sdata);
        . = ALIGN(., 4);
        main_SDATA_END = .;
        main_SDATA_SIZE = ABSOLUTE(main_SDATA_END - main_SDATA_START);
        main_BSS_START = .;
        build/asm/data/800.rodata.s.o(.bss);
        build/src/func_80011270.c.o(.bss);
        build/src/__start.c.o(.bss);
        build/src/func_80011370.c.o(.bss);
        build/src/func_80011C24.c.o(.bss);
        build/src/func_80011DB0.c.o(.bss);
        build/src/func_80011EE8.c.o(.bss);
        build/src/func_80011EF0.c.o(.bss);
        build/src/func_80011F08.c.o(.bss);
        build/src/func_80011F14.c.o(.bss);
        build/src/func_80011F20.c.o(.bss);
        build/src/func_80011F2C.c.o(.bss);
        build/src/func_80011F38.c.o(.bss);
        build/src/func_80011F44.c.o(.bss);
        build/src/func_80011F50.c.o(.bss);
        build/src/func_80011F5C.c.o(.bss);
        build/src/func_80011FD8.c.o(.bss);
        build/src/func_8001202C.c.o(.bss);
        build/src/func_8001205C.c.o(.bss);
        build/src/func_80012098.c.o(.bss);
        build/src/func_800120BC.c.o(.bss);
        build/src/func_800120C8.c.o(.bss);
        build/src/func_800121D4.c.o(.bss);
        build/src/func_80012298.c.o(.bss);
        build/src/func_8001231C.c.o(.bss);
        build/src/func_80012598.c.o(.bss);
        build/src/func_800128DC.c.o(.bss);
        build/src/func_800129E8.c.o(.bss);
        build/src/func_800129F4.c.o(.bss);
        build/src/func_80012A14.c.o(.bss);
        build/src/func_80012A34.c.o(.bss);
        build/src/func_80012A68.c.o(.bss);
        build/src/func_80012AB0.c.o(.bss);
        build/src/func_80012CB4.c.o(.bss);
        build/src/func_80012D30.c.o(.bss);
        build/src/func_8001316C.c.o(.bss);
        build/src/func_8001328C.c.o(.bss);
        build/src/func_800132B8.c.o(.bss);
        build/src/func_800132F0.c.o(.bss);
        build/src/func_80013328.c.o(.bss);
        build/src/func_80013394.c.o(.bss);
        build/src/func_800133B0.c.o(.bss);
        build/src/func_800133D4.c.o(.bss);
        build/src/func_800133E8.c.o(.bss);
        build/src/func_80013400.c.o(.bss);
        build/src/func_80013428.c.o(.bss);
        build/src/func_80013430.c.o(.bss);
        build/src/func_80013438.c.o(.bss);
        build/src/func_80013444.c.o(.bss);
        build/src/func_80013450.c.o(.bss);
        build/src/func_80013488.c.o(.bss);
        build/src/func_800134B8.c.o(.bss);
        build/src/func_800134C4.c.o(.bss);
        build/src/func_80013668.c.o(.bss);
        build/src/func_800136D4.c.o(.bss);
        build/src/func_800139FC.c.o(.bss);
        build/src/func_80013A24.c.o(.bss);
        build/src/func_80013AA4.c.o(.bss);
        build/src/func_80013AC8.c.o(.bss);
        build/src/func_80013AEC.c.o(.bss);
        build/src/func_80013AF8.c.o(.bss);
        build/src/func_80013B04.c.o(.bss);
        build/src/func_80013CD0.c.o(.bss);
        build/src/func_80013F90.c.o(.bss);
        build/src/func_80013FC0.c.o(.bss);
        build/src/func_80014064.c.o(.bss);
        build/src/func_800140C8.c.o(.bss);
        build/src/func_8001413C.c.o(.bss);
        build/src/func_80014250.c.o(.bss);
        build/src/func_800142D8.c.o(.bss);
        build/src/func_80014388.c.o(.bss);
        build/src/func_80014494.c.o(.bss);
        build/src/func_80014554.c.o(.bss);
        build/src/func_800145F0.c.o(.bss);
        build/src/func_80014748.c.o(.bss);
        build/src/func_800147BC.c.o(.bss);
        build/src/func_80014854.c.o(.bss);
        build/src/func_80014988.c.o(.bss);
        build/src/func_80014B38.c.o(.bss);
        build/src/func_80014B44.c.o(.bss);
        build/src/func_80014BCC.c.o(.bss);
        build/src/func_80014CB0.c.o(.bss);
        build/src/func_80014CBC.c.o(.bss);
        build/src/func_80014E90.c.o(.bss);
        build/src/func_80014F0C.c.o(.bss);
        build/src/func_80014FAC.c.o(.bss);
        build/src/func_80015074.c.o(.bss);
        build/src/func_80015114.c.o(.bss);
        build/src/func_800151B4.c.o(.bss);
        build/src/func_8001526C.c.o(.bss);
        build/src/func_8001530C.c.o(.bss);
        build/src/func_800153BC.c.o(.bss);
        build/src/func_800154CC.c.o(.bss);
        build/src/func_80015594.c.o(.bss);
        build/src/func_80015644.c.o(.bss);
        build/src/func_80015704.c.o(.bss);
        build/src/func_80015814.c.o(.bss);
        build/src/func_80015828.c.o(.bss);
        build/src/func_80015840.c.o(.bss);
        build/src/func_8001585C.c.o(.bss);
        build/src/func_80015868.c.o(.bss);
        build/src/func_80015880.c.o(.bss);
        build/src/func_8001588C.c.o(.bss);
        build/src/func_80015894.c.o(.bss);
        build/src/func_8001589C.c.o(.bss);
        build/src/func_800158D8.c.o(.bss);
        build/src/func_800158E4.c.o(.bss);
        build/src/func_80015A18.c.o(.bss);
        build/src/func_80015A34.c.o(.bss);
        build/src/func_80015AA4.c.o(.bss);
        build/src/func_80015AAC.c.o(.bss);
        build/src/func_80015B1C.c.o(.bss);
        build/src/func_80015B24.c.o(.bss);
        build/src/func_80015BF0.c.o(.bss);
        build/src/func_80015C50.c.o(.bss);
        build/src/func_80015CA0.c.o(.bss);
        build/src/func_80015D1C.c.o(.bss);
        build/src/func_80015D6C.c.o(.bss);
        build/src/func_80015DD4.c.o(.bss);
        build/src/func_80015E3C.c.o(.bss);
        build/src/func_80015E78.c.o(.bss);
        build/src/func_80015EE8.c.o(.bss);
        build/src/func_80015F80.c.o(.bss);
        build/src/func_80016054.c.o(.bss);
        build/src/func_800160C8.c.o(.bss);
        build/src/func_800161AC.c.o(.bss);
        build/src/func_80016280.c.o(.bss);
        build/src/func_800165D8.c.o(.bss);
        build/src/func_80016B7C.c.o(.bss);
        build/src/func_80016C08.c.o(.bss);
        build/src/func_8001719C.c.o(.bss);
        build/src/func_800171CC.c.o(.bss);
        build/src/func_80017200.c.o(.bss);
        build/src/func_80017240.c.o(.bss);
        build/src/func_80017284.c.o(.bss);
        build/src/func_80017300.c.o(.bss);
        build/src/func_8001782C.c.o(.bss);
        build/src/func_800179E8.c.o(.bss);
        build/src/func_80017A08.c.o(.bss);
        build/src/func_80017A38.c.o(.bss);
        build/src/func_80017A48.c.o(.bss);
        build/src/func_80017A64.c.o(.bss);
        build/src/func_80017A70.c.o(.bss);
        build/src/func_80017AA0.c.o(.bss);
        build/src/func_80017AC0.c.o(.bss);
        build/src/func_80017AC4.c.o(.bss);
        build/src/func_80017ACC.c.o(.bss);
        build/src/func_80017AE8.c.o(.bss);
        build/src/func_80017B18.c.o(.bss);
        build/src/func_80017B24.c.o(.bss);
        build/src/func_80017B30.c.o(.bss);
        build/src/func_80017B3C.c.o(.bss);
        build/src/func_80017BC8.c.o(.bss);
        build/src/func_80017C04.c.o(.bss);
        build/src/func_80017C24.c.o(.bss);
        build/src/func_80017C30.c.o(.bss);
        build/src/func_80017C3C.c.o(.bss);
        build/src/func_80017C4C.c.o(.bss);
        build/src/func_80017CF4.c.o(.bss);
        build/src/func_80017D9C.c.o(.bss);
        build/src/func_80017E34.c.o(.bss);
        build/src/func_80017EA0.c.o(.bss);
        build/src/func_80017EE4.c.o(.bss);
        build/src/func_80017EEC.c.o(.bss);
        build/src/func_80017EF0.c.o(.bss);
        build/src/func_80017F10.c.o(.bss);
        build/src/func_80017F28.c.o(.bss);
        build/src/func_80017F30.c.o(.bss);
        build/src/func_80017F88.c.o(.bss);
        build/src/func_800183B8.c.o(.bss);
        build/src/func_800183D0.c.o(.bss);
        build/src/func_800183E0.c.o(.bss);
        build/src/func_80018B8C.c.o(.bss);
        build/src/func_80018B98.c.o(.bss);
        build/src/func_80019030.c.o(.bss);
        build/src/func_80019070.c.o(.bss);
        build/src/func_800191B4.c.o(.bss);
        build/src/func_8001929C.c.o(.bss);
        build/src/func_800193F0.c.o(.bss);
        build/src/func_8001945C.c.o(.bss);
        build/src/func_80019564.c.o(.bss);
        build/src/func_800195F4.c.o(.bss);
        build/src/func_80019600.c.o(.bss);
        build/src/func_80019610.c.o(.bss);
        build/src/func_800197FC.c.o(.bss);
        build/src/func_800198E0.c.o(.bss);
        build/src/func_800199F8.c.o(.bss);
        build/src/func_80019AD0.c.o(.bss);
        build/src/func_80019CBC.c.o(.bss);
        build/src/func_80019E14.c.o(.bss);
        build/src/func_80019E50.c.o(.bss);
        build/src/func_80019E80.c.o(.bss);
        build/src/func_80019FAC.c.o(.bss);
        build/src/func_80019FC4.c.o(.bss);
        build/src/func_8001A018.c.o(.bss);
        build/src/func_8001A11C.c.o(.bss);
        build/src/func_8001A19C.c.o(.bss);
        build/src/func_8001A284.c.o(.bss);
        build/src/func_8001A574.c.o(.bss);
        build/src/func_8001A668.c.o(.bss);
        build/src/func_8001A6FC.c.o(.bss);
        build/src/func_8001A790.c.o(.bss);
        build/src/func_8001A808.c.o(.bss);
        build/src/func_8001A870.c.o(.bss);
        build/src/func_8001A8D0.c.o(.bss);
        build/src/func_8001A8FC.c.o(.bss);
        build/src/func_8001A910.c.o(.bss);
        build/src/func_8001A940.c.o(.bss);
        build/src/func_8001A948.c.o(.bss);
        build/src/func_8001A950.c.o(.bss);
        build/src/func_8001A958.c.o(.bss);
        build/src/func_8001A960.c.o(.bss);
        build/src/func_8001A968.c.o(.bss);
        build/src/func_8001A970.c.o(.bss);
        build/src/func_8001AA7C.c.o(.bss);
        build/src/func_8001AAB8.c.o(.bss);
        build/src/func_8001AAF4.c.o(.bss);
        build/src/func_8001ABF0.c.o(.bss);
        build/src/func_8001AC10.c.o(.bss);
        build/src/func_8001ACA0.c.o(.bss);
        build/src/func_8001ACBC.c.o(.bss);
        build/src/func_8001AD00.c.o(.bss);
        build/src/func_8001AD6C.c.o(.bss);
        build/src/func_8001ADD8.c.o(.bss);
        build/src/func_8001AE34.c.o(.bss);
        build/src/func_8001AF34.c.o(.bss);
        build/src/func_8001AF44.c.o(.bss);
        build/src/func_8001AF70.c.o(.bss);
        build/src/func_8001AFB0.c.o(.bss);
        build/src/func_8001AFE0.c.o(.bss);
        build/src/func_8001B028.c.o(.bss);
        build/src/func_8001B074.c.o(.bss);
        build/src/func_8001B100.c.o(.bss);
        build/src/func_8001B10C.c.o(.bss);
        build/src/func_8001B118.c.o(.bss);
        build/src/func_8001B258.c.o(.bss);
        build/src/func_8001B2CC.c.o(.bss);
        build/src/func_8001B3CC.c.o(.bss);
        build/src/func_8001B3EC.c.o(.bss);
        build/src/func_8001B4D0.c.o(.bss);
        build/src/func_8001B4E4.c.o(.bss);
        build/src/func_8001B530.c.o(.bss);
        build/src/func_8001B5DC.c.o(.bss);
        build/src/func_8001B6A0.c.o(.bss);
        build/src/func_8001B9F8.c.o(.bss);
        build/src/func_8001BA18.c.o(.bss);
        build/src/func_8001BA40.c.o(.bss);
        build/src/func_8001BA5C.c.o(.bss);
        build/src/func_8001BAC4.c.o(.bss);
        build/src/func_8001BB28.c.o(.bss);
        build/src/func_8001BB88.c.o(.bss);
        build/src/func_8001BBD8.c.o(.bss);
        build/src/func_8001BD64.c.o(.bss);
        build/src/func_8001BE18.c.o(.bss);
        build/src/func_8001BF74.c.o(.bss);
        build/src/func_8001BF88.c.o(.bss);
        build/src/func_8001BF9C.c.o(.bss);
        build/src/func_8001BFA8.c.o(.bss);
        build/src/func_8001BFD8.c.o(.bss);
        build/src/func_8001BFE0.c.o(.bss);
        build/src/func_8001BFEC.c.o(.bss);
        build/src/func_8001C0D4.c.o(.bss);
        build/src/func_8001C1C0.c.o(.bss);
        build/src/func_8001C37C.c.o(.bss);
        build/src/func_8001D21C.c.o(.bss);
        build/src/func_8001D284.c.o(.bss);
        build/src/func_8001D288.c.o(.bss);
        build/src/func_8001D2A4.c.o(.bss);
        build/src/func_8001D2D0.c.o(.bss);
        build/src/func_8001D2D8.c.o(.bss);
        build/src/func_8001D2F4.c.o(.bss);
        build/src/func_8001D2FC.c.o(.bss);
        build/src/func_8001D340.c.o(.bss);
        build/src/func_8001D348.c.o(.bss);
        build/src/func_8001D648.c.o(.bss);
        build/src/func_8001D678.c.o(.bss);
        build/src/func_8001D6AC.c.o(.bss);
        build/src/func_8001D6B8.c.o(.bss);
        build/src/func_8001D86C.c.o(.bss);
        build/src/func_8001D884.c.o(.bss);
        build/src/func_8001D8A0.c.o(.bss);
        build/src/func_8001D8B8.c.o(.bss);
        build/src/func_8001DBF0.c.o(.bss);
        build/src/func_8001DCA8.c.o(.bss);
        build/src/func_8001DCB0.c.o(.bss);
        build/src/func_8001DE4C.c.o(.bss);
        build/src/func_8001DFC8.c.o(.bss);
        build/src/func_8001DFD4.c.o(.bss);
        build/src/func_8001E04C.c.o(.bss);
        build/src/func_8001E088.c.o(.bss);
        build/src/func_8001E0B8.c.o(.bss);
        build/src/func_8001E158.c.o(.bss);
        build/src/func_8001E160.c.o(.bss);
        build/src/func_8001E26C.c.o(.bss);
        build/src/func_8001E334.c.o(.bss);
        build/src/func_8001E340.c.o(.bss);
        build/src/func_8001E38C.c.o(.bss);
        build/src/func_8001E4C0.c.o(.bss);
        build/src/func_8001E6FC.c.o(.bss);
        build/src/func_8001E78C.c.o(.bss);
        build/src/func_8001E7B8.c.o(.bss);
        build/src/func_8001E7C0.c.o(.bss);
        build/src/func_8001E7DC.c.o(.bss);
        build/src/func_8001E818.c.o(.bss);
        build/src/func_8001E820.c.o(.bss);
        build/src/func_8001E878.c.o(.bss);
        build/src/func_8001E9F8.c.o(.bss);
        build/src/func_8001EAE4.c.o(.bss);
        build/src/func_8001EF8C.c.o(.bss);
        build/src/func_8001EF98.c.o(.bss);
        build/src/func_8001EFA4.c.o(.bss);
        build/src/func_8001F038.c.o(.bss);
        build/src/func_8001F084.c.o(.bss);
        build/src/func_8001F100.c.o(.bss);
        build/src/func_8001F190.c.o(.bss);
        build/src/func_8001F1B4.c.o(.bss);
        build/src/func_8001F1C0.c.o(.bss);
        build/src/func_8001F1E0.c.o(.bss);
        build/src/func_8001F250.c.o(.bss);
        build/src/func_8001F278.c.o(.bss);
        build/src/func_8001F2EC.c.o(.bss);
        build/src/func_8001F338.c.o(.bss);
        build/src/func_8001F35C.c.o(.bss);
        build/src/func_8001F39C.c.o(.bss);
        build/src/func_8001F3DC.c.o(.bss);
        build/src/func_8001F41C.c.o(.bss);
        build/src/func_8001F424.c.o(.bss);
        build/src/func_8001F42C.c.o(.bss);
        build/src/func_8001F5B8.c.o(.bss);
        build/src/func_8001F5EC.c.o(.bss);
        build/src/func_8001F664.c.o(.bss);
        build/src/func_8001F774.c.o(.bss);
        build/src/func_8001F8A4.c.o(.bss);
        build/src/func_8001FA0C.c.o(.bss);
        build/src/func_8001FA98.c.o(.bss);
        build/src/func_8001FAB4.c.o(.bss);
        build/src/func_8001FABC.c.o(.bss);
        build/src/func_8001FAE8.c.o(.bss);
        build/src/func_8001FB08.c.o(.bss);
        build/src/func_8001FB10.c.o(.bss);
        build/src/func_8001FB30.c.o(.bss);
        build/src/func_8001FBBC.c.o(.bss);
        build/src/func_8001FBE4.c.o(.bss);
        build/src/func_8001FBF0.c.o(.bss);
        build/src/func_8001FCDC.c.o(.bss);
        build/src/func_8001FCE4.c.o(.bss);
        build/src/func_8001FD10.c.o(.bss);
        build/src/func_8001FD74.c.o(.bss);
        build/src/func_8001FD84.c.o(.bss);
        build/src/func_8001FE00.c.o(.bss);
        build/src/func_8001FE34.c.o(.bss);
        build/src/func_8001FE6C.c.o(.bss);
        build/src/func_8001FE7C.c.o(.bss);
        build/src/func_8001FEA4.c.o(.bss);
        build/src/func_8001FF70.c.o(.bss);
        build/src/func_8001FF98.c.o(.bss);
        build/src/func_800200E4.c.o(.bss);
        build/src/func_80020148.c.o(.bss);
        build/src/func_80020174.c.o(.bss);
        build/src/func_800201C4.c.o(.bss);
        build/src/func_8002029C.c.o(.bss);
        build/src/func_800202F8.c.o(.bss);
        build/src/func_8002039C.c.o(.bss);
        build/src/func_8002040C.c.o(.bss);
        build/src/func_80020414.c.o(.bss);
        build/src/func_8002047C.c.o(.bss);
        build/src/func_800204E0.c.o(.bss);
        build/src/func_80020540.c.o(.bss);
        build/src/func_80020570.c.o(.bss);
        build/src/func_8002066C.c.o(.bss);
        build/src/func_80020768.c.o(.bss);
        build/src/func_80020790.c.o(.bss);
        build/src/func_800207DC.c.o(.bss);
        build/src/func_800207E4.c.o(.bss);
        build/src/func_80020818.c.o(.bss);
        build/src/func_80020900.c.o(.bss);
        build/src/func_8002093C.c.o(.bss);
        build/src/func_80020964.c.o(.bss);
        build/src/func_8002098C.c.o(.bss);
        build/src/func_800209B0.c.o(.bss);
        build/src/func_800209D4.c.o(.bss);
        build/src/func_800209F4.c.o(.bss);
        build/src/func_80020A14.c.o(.bss);
        build/src/func_80020A40.c.o(.bss);
        build/src/func_80020A70.c.o(.bss);
        build/src/func_80020A7C.c.o(.bss);
        build/src/func_80020A88.c.o(.bss);
        build/src/func_80020A94.c.o(.bss);
        build/src/func_80020B80.c.o(.bss);
        build/src/func_80020E38.c.o(.bss);
        build/src/func_80020E58.c.o(.bss);
        build/src/func_800212A8.c.o(.bss);
        build/src/func_80021484.c.o(.bss);
        build/src/func_800214FC.c.o(.bss);
        build/src/func_800215EC.c.o(.bss);
        build/src/func_80021604.c.o(.bss);
        build/src/func_80021668.c.o(.bss);
        build/src/func_800217B0.c.o(.bss);
        build/src/func_80021818.c.o(.bss);
        build/src/func_80021820.c.o(.bss);
        build/src/func_80021844.c.o(.bss);
        build/src/func_800218A8.c.o(.bss);
        build/src/func_800218BC.c.o(.bss);
        build/src/func_800218C4.c.o(.bss);
        build/src/func_8002194C.c.o(.bss);
        build/src/func_80021B20.c.o(.bss);
        build/src/func_80021B64.c.o(.bss);
        build/src/func_80021B84.c.o(.bss);
        build/src/func_80021B88.c.o(.bss);
        build/src/func_80021B90.c.o(.bss);
        build/src/func_80021CD8.c.o(.bss);
        build/src/func_80021D64.c.o(.bss);
        build/src/func_80021D70.c.o(.bss);
        build/src/func_80021D78.c.o(.bss);
        build/src/func_80021D80.c.o(.bss);
        build/src/func_80021D88.c.o(.bss);
        build/src/func_80021D90.c.o(.bss);
        build/src/func_80021D98.c.o(.bss);
        build/src/func_80021DA0.c.o(.bss);
        build/src/func_80021DA8.c.o(.bss);
        build/src/func_80021E60.c.o(.bss);
        build/src/func_80021FD0.c.o(.bss);
        build/src/func_80021FE4.c.o(.bss);
        build/src/func_80022008.c.o(.bss);
        build/src/func_80022014.c.o(.bss);
        build/src/func_80022028.c.o(.bss);
        build/src/func_80022030.c.o(.bss);
        build/src/func_80022048.c.o(.bss);
        build/src/func_8002206C.c.o(.bss);
        build/src/func_8002238C.c.o(.bss);
        build/src/func_800223B0.c.o(.bss);
        build/src/func_800223D4.c.o(.bss);
        build/src/func_800224F0.c.o(.bss);
        build/src/func_80022528.c.o(.bss);
        build/src/func_80022580.c.o(.bss);
        build/src/func_800225B8.c.o(.bss);
        build/src/func_800225C4.c.o(.bss);
        build/src/func_8002261C.c.o(.bss);
        build/src/func_800226A4.c.o(.bss);
        build/src/func_800226B0.c.o(.bss);
        build/src/func_800226D8.c.o(.bss);
        build/src/func_800226E4.c.o(.bss);
        build/src/func_800226F0.c.o(.bss);
        build/src/func_80022738.c.o(.bss);
        build/src/func_80022788.c.o(.bss);
        build/src/func_80022794.c.o(.bss);
        build/src/func_80022964.c.o(.bss);
        build/src/func_800229F4.c.o(.bss);
        build/src/func_80022AF0.c.o(.bss);
        build/src/func_80022B20.c.o(.bss);
        build/src/func_80022B98.c.o(.bss);
        build/src/func_80022D70.c.o(.bss);
        build/src/func_80022DF8.c.o(.bss);
        build/src/func_80022EA4.c.o(.bss);
        build/src/func_80022F1C.c.o(.bss);
        build/src/func_80022F80.c.o(.bss);
        build/src/func_80022F90.c.o(.bss);
        build/src/func_80022FA0.c.o(.bss);
        build/src/func_80022FB4.c.o(.bss);
        build/src/func_80022FD4.c.o(.bss);
        build/src/func_80022FD8.c.o(.bss);
        build/src/func_80022FE0.c.o(.bss);
        build/src/func_8002301C.c.o(.bss);
        build/src/func_80023030.c.o(.bss);
        build/src/func_80023060.c.o(.bss);
        build/src/func_80023100.c.o(.bss);
        build/src/func_80023130.c.o(.bss);
        build/src/func_80023170.c.o(.bss);
        build/src/func_800231AC.c.o(.bss);
        build/src/func_800231E8.c.o(.bss);
        build/src/func_80023288.c.o(.bss);
        build/src/func_800233B4.c.o(.bss);
        build/src/func_8002348C.c.o(.bss);
        build/src/func_80023600.c.o(.bss);
        build/src/func_800236EC.c.o(.bss);
        build/src/func_80023710.c.o(.bss);
        build/src/func_8002374C.c.o(.bss);
        build/src/func_80023774.c.o(.bss);
        build/src/func_80023794.c.o(.bss);
        build/src/func_800237FC.c.o(.bss);
        build/src/func_80023910.c.o(.bss);
        build/src/func_800239F8.c.o(.bss);
        build/src/func_80023A74.c.o(.bss);
        build/src/func_80023A9C.c.o(.bss);
        build/src/func_80023B5C.c.o(.bss);
        build/src/func_80023C2C.c.o(.bss);
        build/src/func_80023CA4.c.o(.bss);
        build/src/func_80023CE8.c.o(.bss);
        build/src/func_80023D08.c.o(.bss);
        build/src/func_80023DBC.c.o(.bss);
        build/src/func_80024030.c.o(.bss);
        build/src/func_80024108.c.o(.bss);
        build/src/func_800241EC.c.o(.bss);
        build/src/func_8002437C.c.o(.bss);
        build/src/func_800243A4.c.o(.bss);
        build/src/func_800243C0.c.o(.bss);
        build/src/func_800243C8.c.o(.bss);
        build/src/func_800243D0.c.o(.bss);
        build/src/func_800243F8.c.o(.bss);
        build/src/func_80024400.c.o(.bss);
        build/src/func_80024408.c.o(.bss);
        build/src/func_80024430.c.o(.bss);
        build/src/func_80024434.c.o(.bss);
        build/src/func_80024440.c.o(.bss);
        build/src/func_80024448.c.o(.bss);
        build/src/func_800244FC.c.o(.bss);
        build/src/func_80024578.c.o(.bss);
        build/src/func_800245C8.c.o(.bss);
        build/src/func_800245F4.c.o(.bss);
        build/src/func_8002462C.c.o(.bss);
        build/src/func_80024664.c.o(.bss);
        build/src/func_8002469C.c.o(.bss);
        build/src/func_800246D4.c.o(.bss);
        build/src/func_8002470C.c.o(.bss);
        build/src/func_80024764.c.o(.bss);
        build/src/func_80024770.c.o(.bss);
        build/src/func_800247C0.c.o(.bss);
        build/src/func_80024810.c.o(.bss);
        build/src/func_80024860.c.o(.bss);
        build/src/func_800248B0.c.o(.bss);
        build/src/func_800248E8.c.o(.bss);
        build/src/func_80024924.c.o(.bss);
        build/src/func_8002495C.c.o(.bss);
        build/src/func_800249B4.c.o(.bss);
        build/src/func_800249C0.c.o(.bss);
        build/src/func_80024A10.c.o(.bss);
        build/src/func_80024A4C.c.o(.bss);
        build/src/func_80038674.c.o(.bss);
        . = ALIGN(., 4);
        main_BSS_END = .;
        main_BSS_SIZE = ABSOLUTE(main_BSS_END - main_BSS_START);
    }
    __romPos += SIZEOF(.main);
    __romPos = ALIGN(__romPos, 4);
    . = ALIGN(., 4);
    main_ROM_END = __romPos;
    main_VRAM_END = .;

    /* Library BSS entries (added by patchLinkerBss.ts) */
    .lib_bss 0x800A0758 (NOLOAD) : SUBALIGN(4)
    {
        build/lib/libspu/spu.o(.bss);
        build/lib/libsnd/ssinit.o(.bss);
        build/lib/libsnd/vm_f.o(.bss);
        build/lib/libsnd/vm_g.o(.bss);
        build/lib/libsnd/vm_init.o(.bss);
        build/lib/libcd/iso9660.o(.bss);
        build/lib/libcd/bios_1.o(.bss);
        build/lib/libgte/patchgte.o(.bss);
        build/lib/libgs/gs_001.o(.bss);
        build/lib/libgs/gs_104.o(.bss);
        build/lib/libgs/gs_107.o(.bss);
        build/lib/libgs/gs_128.o(.bss);
        build/lib/libgs/global.o(.bss);
        build/lib/libgpu/font.o(.bss);
        build/lib/libgpu/kprintf.o(.bss);
        build/lib/libgpu/sys.o(.bss);
        build/lib/libcard/patch.o(.bss);
        build/lib/libcard/end.o(.bss);
        build/lib/libmcrd/libmcrd.o(.bss);
        build/lib/libmcrd/userfunc.o(.bss);
        build/lib/libmcrd/bios.o(.bss);
        build/lib/libmcrd/low.o(.bss);
        build/lib/libapi/first.o(.bss);
        build/lib/libapi/pad.o(.bss);
        build/lib/libapi/patch.o(.bss);
        build/lib/libapi/chclrpad.o(.bss);
        build/lib/libmcx/mcxcmd23.o(.bss);
        build/lib/libmcx/mcxresi.o(.bss);
        build/lib/libmcx/mcxmain.o(.bss);
        build/lib/libpad/pddirres.o(.bss);
        build/lib/libpad/pdresres.o(.bss);
    }

    /DISCARD/ :
    {
        *(*);
    }
}
INCLUDE "build/undefined_funcs_auto.txt"
INCLUDE "build/undefined_syms_auto.txt"
INCLUDE "build/dep_syms.txt"
INCLUDE "build/lib_bss_syms.txt"
INCLUDE "build/globals_aliases.txt"
